## src/Kconfig.logging
```kconfig
#
# Copyright (C) 2024 Golioth, Inc.
#
# SPDX-License-Identifier: Apache-2.0
#

config GOLIOTH_DEBUG_LOG
    bool "Enable internal debug logs"
    default y
    help
        Enable/disable GLTH_LOGX log statements.

        If disabled, then the GLTH_LOGX macros will
        be removed/undefined.

config GOLIOTH_AUTO_LOG_TO_CLOUD
    bool "Enable automatic logging to Golioth"
    default y
    help
        Enable/disable automatic logging to Golioth for GLTH_LOGX statements

        If enabled, GLTH_LOGX statements will log to stdout as well as to
        Golioth. If disabled, they will only go to stdout.

        Enabling can result is a large amount of data transmitted to Golioth,
        so use with caution.

        If you enable this, it might be a good idea to increase
        GOLIOTH_COAP_REQUEST_QUEUE_MAX_ITEMS, since there will be many
        more CoAP requests (one per GLTH_LOGX statement). Otherwise you
        will see warnings like "Failed to enqueue request, queue full".

        There is an internal feature flag that is set by default to the value of this
        configuration item. The flag can also be set at runtime.

config GOLIOTH_DEBUG_DEFAULT_LOG_LEVEL
    int "Default log level for Golioth SDK"
    default 3
    help
        The default log level, which is used to filter GLTH_LOGX statements.

        0: None
        1: Error
        2: Warn
        3: Info
        4: Debug
        5: Verbose

        This value can be overriden at runtime with golioth_debug_set_log_level().

config GOLIOTH_LOG_LEGACY
    bool "Enable legacy Golioth logs ingestion [DEPRECATED]"
    default n
    help
        Send log messages to Golioth legacy logging ingestion system. Enabling
        removes the ability to process logs in Golioth Pipelines and deliver
        them to external destinations.

if !GOLIOTH_LOG_LEGACY

config GOLIOTH_LOG_PIPELINES_PATH
    string "Logs Pipelines path"
    default "logs"
    help
        Path to use when delivering log messages to Golioth Pipelines.
        A Pipeline that filters on this path and application/cbor content type
        should exist in the target Golioth project.

endif
```

## tests/hil/platform/esp-idf/sdkconfig.defaults
```kconfig
CONFIG_MBEDTLS_SSL_PROTO_DTLS=y
CONFIG_MBEDTLS_PSK_MODES=y
CONFIG_MBEDTLS_KEY_EXCHANGE_PSK=y
CONFIG_MBEDTLS_TLS_CLIENT_ONLY=y
CONFIG_MBEDTLS_SHA512_C=n
CONFIG_LWIP_NETBUF_RECVINFO=y
CONFIG_FREERTOS_USE_TRACE_FACILITY=y
CONFIG_FREERTOS_USE_STATS_FORMATTING_FUNCTIONS=y
CONFIG_ESP_WIFI_SOFTAP_SUPPORT=n

CONFIG_COMPILER_OPTIMIZATION_SIZE=y

# OTA Partition Table
CONFIG_ESPTOOLPY_FLASHSIZE_4MB=y

# If the new app firmware does not cancel the rollback,
# then this will ensure that rollback happens automatically
# if/when the device is next rebooted.
CONFIG_BOOTLOADER_APP_ROLLBACK_ENABLE=y

# GLTH_LOGX statements will automatically upload to Golioth Logs service
CONFIG_GOLIOTH_AUTO_LOG_TO_CLOUD=y
CONFIG_GOLIOTH_COAP_REQUEST_QUEUE_MAX_ITEMS=20

# Golioth Services
CONFIG_GOLIOTH_FW_UPDATE=y
CONFIG_GOLIOTH_SETTINGS=y
CONFIG_GOLIOTH_STREAM=y
CONFIG_GOLIOTH_RPC=y
CONFIG_GOLIOTH_LIGHTDB_STATE=y
CONFIG_GOLIOTH_LIGHTDB_STATE_FLOAT_HELPERS=y

# Allow multiple artifacts in a manifest
CONFIG_GOLIOTH_OTA_MAX_NUM_COMPONENTS=2

# Allow for larger error message buffer for Settings service
CONFIG_GOLIOTH_SETTINGS_MAX_RESPONSE_LEN=512
```

## tests/hil/platform/zephyr/testcase.yaml
```yaml
common:
  harness: pytest
  tags:
    - golioth
    - socket
    - goliothd
  platform_allow:
    - esp32s3_devkitc/esp32s3/procpu
    - frdm_rw612
    - native_sim
    - native_sim/native/64
    - nrf52840dk/nrf52840
    - nrf9160dk/nrf9160/ns
    - rak5010/nrf52840
  timeout: 600
tests:
  golioth.hil.connection:
    harness_config:
      pytest_dut_scope: module
      pytest_root:
        - ../../tests/connection
    extra_args:
      - GOLIOTH_HIL_TEST=connection
  golioth.hil.lightdb:
    harness_config:
      pytest_dut_scope: module
      pytest_root:
        - ../../tests/lightdb
    extra_args:
      - GOLIOTH_HIL_TEST=lightdb
  golioth.hil.ota:
    harness_config:
      pytest_dut_scope: module
      pytest_root:
        - ../../tests/ota
    extra_args:
      - GOLIOTH_HIL_TEST=ota
  golioth.hil.rpc:
    harness_config:
      pytest_dut_scope: module
      pytest_root:
        - ../../tests/rpc
    extra_args:
      - GOLIOTH_HIL_TEST=rpc
  golioth.hil.settings:
    harness_config:
      pytest_dut_scope: module
      pytest_root:
        - ../../tests/settings
    extra_args:
      - GOLIOTH_HIL_TEST=settings
  golioth.hil.stream:
    harness_config:
      pytest_dut_scope: module
      pytest_root:
        - ../../tests/stream
    extra_args:
      - GOLIOTH_HIL_TEST=stream
```

## zephyr/boards/shields/golioth_esp_at/Kconfig.shield
```kconfig
# Copyright (c) 2025 Golioth, Inc.
# SPDX-License-Identifier: Apache-2.0

config SHIELD_GOLIOTH_ESP_AT
	def_bool $(shields_list_contains,golioth_esp_at)
```
