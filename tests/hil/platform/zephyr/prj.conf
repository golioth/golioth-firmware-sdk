## CMakeLists.txt
```
# SPDX-License-Identifier: Apache-2.0

cmake_minimum_required(VERSION 3.20.0)

find_package(Zephyr REQUIRED HINTS $ENV{ZEPHYR_BASE})
project(test)

zephyr_get(GOLIOTH_HIL_TEST)

target_sources(app PRIVATE src/main.c ../../tests/${GOLIOTH_HIL_TEST}/test.c)
```

## Kconfig
```
# Copyright (c) 2023 Golioth, Inc.
# SPDX-License-Identifier: Apache-2.0

source "${ZEPHYR_GOLIOTH_FIRMWARE_SDK_MODULE_DIR}/examples/zephyr/common/Kconfig.defconfig"

configdefault GOLIOTH_SAMPLE_WIFI_SETTINGS
	bool
	default y

choice GOLIOTH_SAMPLE_CREDENTIALS
	default GOLIOTH_SAMPLE_CREDENTIALS_SETTINGS if (GOLIOTH_AUTH_METHOD_PSK && SETTINGS)
endchoice

source "Kconfig.zephyr"
```

## prj.conf
```kconfig
# Golioth Firmware SDK
CONFIG_GOLIOTH_FIRMWARE_SDK=y
CONFIG_GOLIOTH_SAMPLE_COMMON=y

# Golioth Services
CONFIG_GOLIOTH_OTA=y
CONFIG_GOLIOTH_SETTINGS=y
CONFIG_GOLIOTH_STREAM=y
CONFIG_GOLIOTH_RPC=y
CONFIG_GOLIOTH_LIGHTDB_STATE=y
CONFIG_GOLIOTH_LIGHTDB_STATE_FLOAT_HELPERS=y

CONFIG_FLASH=y
CONFIG_FLASH_MAP=y
CONFIG_STREAM_FLASH=y
CONFIG_IMG_MANAGER=y

# Runtime settings
CONFIG_NVS=y
CONFIG_SETTINGS=y
CONFIG_SETTINGS_RUNTIME=y
CONFIG_SHELL_BACKEND_SERIAL_RX_RING_BUFFER_SIZE=128

# Application
CONFIG_LOG_BACKEND_GOLIOTH=n
CONFIG_REBOOT=y
CONFIG_CBPRINTF_FP_SUPPORT=y
CONFIG_SHELL_BACKEND_SERIAL_LOG_MESSAGE_QUEUE_SIZE=1024

# Allow multiple artifacts in a manifest
CONFIG_GOLIOTH_OTA_MAX_NUM_COMPONENTS=2

# Allow for larger error message buffer for Settings service
CONFIG_GOLIOTH_SETTINGS_MAX_RESPONSE_LEN=512

# Double log memory to prevent dropped logs on settings test
CONFIG_LOG_BUFFER_SIZE=2048

# Increase maximum CoAP path length
CONFIG_COAP_EXTENDED_OPTIONS_LEN=y
CONFIG_COAP_EXTENDED_OPTIONS_LEN_VALUE=39

CONFIG_ZVFS_EVENTFD_MAX=16
CONFIG_ZVFS_OPEN_MAX=25
```

## boards/frdm_rw612.conf
```kconfig
CONFIG_GOLIOTH_SAMPLE_DHCP_BIND=y
CONFIG_NET_DHCPV4=y
CONFIG_BUILD_OUTPUT_HEX=y
```

## boards/native_sim_64.conf
```kconfig
# Use offloaded sockets using host BSD sockets
CONFIG_ETH_DRIVER=n
CONFIG_ETH_NATIVE_POSIX=n
CONFIG_NET_DRIVERS=y
CONFIG_NET_SOCKETS=y
CONFIG_NET_SOCKETS_OFFLOAD=y
CONFIG_NET_NATIVE_OFFLOADED_SOCKETS=y
CONFIG_HEAP_MEM_POOL_SIZE=1024

# Use embedded libc to use Zephyr's eventfd instead of host eventfd
CONFIG_PICOLIBC=y

# Static networking
CONFIG_NET_CONFIG_LOG_LEVEL_DBG=y
CONFIG_NET_CONFIG_SETTINGS=y
CONFIG_NET_CONFIG_NEED_IPV4=y
CONFIG_NET_CONFIG_MY_IPV4_ADDR="192.0.2.1"
CONFIG_NET_CONFIG_MY_IPV4_GW="192.0.2.2"
CONFIG_NET_CONFIG_PEER_IPV4_ADDR="192.0.2.2"

# Golioth logging backend requirement
CONFIG_LOG_MODE_DEFERRED=y

# Allow easy communication with Python trio.run_process()
CONFIG_NATIVE_UART_0_ON_STDINOUT=y
CONFIG_LOG_BACKEND_NATIVE_POSIX=n
```

## boards/nrf52840dk_nrf52840.conf
```kconfig
CONFIG_NET_PKT_TX_COUNT=12
CONFIG_NET_BUF_TX_COUNT=32
```

## boards/nrf9160dk_nrf9160_ns.conf
```kconfig
# General config
CONFIG_HEAP_MEM_POOL_SIZE=4096
CONFIG_NEWLIB_LIBC=y

# Networking
CONFIG_NET_SOCKETS_OFFLOAD=y
CONFIG_NET_IPV6=y
CONFIG_NET_IPV6_NBR_CACHE=n
CONFIG_NET_IPV6_MLD=n

# Increase native TLS socket implementation, so that it is chosen instead of
# offloaded nRF91 sockets
CONFIG_NET_SOCKETS_TLS_PRIORITY=35

# Modem library
CONFIG_NRF_MODEM_LIB=y

# LTE connectivity with network connection manager
CONFIG_NRF_MODEM_LIB_NET_IF=y
CONFIG_NRF_MODEM_LIB_NET_IF_AUTO_START=y
CONFIG_NRF_MODEM_LIB_NET_IF_AUTO_CONNECT=y
CONFIG_NET_CONNECTION_MANAGER=y
CONFIG_NET_CONNECTION_MANAGER_MONITOR_STACK_SIZE=1024

# Increased sysworkq size, due to LTE connectivity
CONFIG_SYSTEM_WORKQUEUE_STACK_SIZE=2048

# Disable options y-selected by NCS for no good reason
CONFIG_MBEDTLS_KEY_EXCHANGE_DHE_PSK_ENABLED=n
CONFIG_MBEDTLS_KEY_EXCHANGE_DHE_RSA_ENABLED=n

# Generate MCUboot compatible images
CONFIG_BOOTLOADER_MCUBOOT=y

# Override modem reset loop protection
CONFIG_GOLIOTH_SAMPLE_NRF91_RESET_LOOP_OVERRIDE=y
```

## boards/rpi_pico2_rp2350a_m33_w.conf
```kconfig
CONFIG_NETWORKING=y
CONFIG_TEST_RANDOM_GENERATOR=y

CONFIG_NET_DHCPV4=y

CONFIG_NET_IPV4=y
CONFIG_NET_IPV6=n

CONFIG_WIFI=y
CONFIG_WIFI_LOG_LEVEL_ERR=y
CONFIG_NET_L2_WIFI_SHELL=y
CONFIG_GOLIOTH_SAMPLE_WIFI=y

CONFIG_IMG_MANAGER=n
```

## socs/native.conf
```kconfig
# Use offloaded sockets using host BSD sockets
CONFIG_ETH_DRIVER=n
CONFIG_ETH_NATIVE_POSIX=n
CONFIG_NET_DRIVERS=y
CONFIG_NET_SOCKETS=y
CONFIG_NET_SOCKETS_OFFLOAD=y
CONFIG_NET_NATIVE_OFFLOADED_SOCKETS=y

# Use embedded libc to use Zephyr's eventfd instead of host eventfd
CONFIG_PICOLIBC=y

# Static networking
CONFIG_NET_CONFIG_LOG_LEVEL_DBG=y
CONFIG_NET_CONFIG_SETTINGS=y
CONFIG_NET_CONFIG_NEED_IPV4=y
CONFIG_NET_CONFIG_MY_IPV4_ADDR="192.0.2.1"
CONFIG_NET_CONFIG_MY_IPV4_GW="192.0.2.2"
CONFIG_NET_CONFIG_PEER_IPV4_ADDR="192.0.2.2"

# Golioth logging backend requirement
CONFIG_LOG_MODE_DEFERRED=y

# Allow easy communication with Python trio.run_process()
CONFIG_UART_NATIVE_PTY_0_ON_STDINOUT=y
CONFIG_LOG_BACKEND_NATIVE_POSIX=n

# Coverage
CONFIG_COVERAGE=y
```

## boards/rak5010_nrf52840.overlay
```dts
/ {
	chosen {
		zephyr,console = &cdc_acm_uart0;
		zephyr,shell-uart = &cdc_acm_uart0;
	};
};

&zephyr_udc0 {
	cdc_acm_uart0: cdc_acm_uart0 {
		compatible = "zephyr,cdc-acm-uart";
	};
};
```

## boards/rpi_pico2_rp2350a_m33_w.overlay
```dts
/* Partitioning for the RP2350A-M33 board using 4M flash.
 */
#include <raspberrypi/partitions_4M_default.dtsi>
```

## src/main.c
```c
/*
 * Copyright (c) 2023 Golioth, Inc.
 *
 * SPDX-License-Identifier: Apache-2.0
 */

#include <zephyr/logging/log.h>
LOG_MODULE_REGISTER(test, LOG_LEVEL_DBG);

#include <samples/common/net_connect.h>
#include <samples/common/sample_credentials.h>

void hil_test_entry(const struct golioth_client_config *config);

int main(void)
{
    net_connect();

    hil_test_entry(golioth_sample_credentials_get());

    return 0;
}
```
