## tests/zephyr/coap_req/testcase.yaml
```yaml
tests:
  golioth.coap_req:
    tags:
      - golioth
    platform_allow:
      - native_sim
      - native_sim/native/64
    integration_platforms:
      - native_sim
```
