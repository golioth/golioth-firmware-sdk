## CMakeLists.txt
```
# SPDX-License-Identifier: Apache-2.0

cmake_minimum_required(VERSION 3.20.0)

if(BOARD STREQUAL "nrf52840dk/nrf52840")
    if(NOT SHIELD)
        set(SHIELD golioth_esp_at)
        message(WARNING "Selecting golioth_esp_at SHIELD.")
    endif()
endif()

find_package(Zephyr REQUIRED HINTS $ENV{ZEPHYR_BASE})
project(lightdb)

target_sources(app PRIVATE src/main.c)
```

## sample.yaml
```
sample:
  description: Use LightDB get
  name: lightdb-get
common:
  harness: pytest
  tags:
    - golioth
    - lightdb
    - socket
    - goliothd
tests:
  sample.golioth.lightdb_get:
    timeout: 180
    extra_configs:
      - CONFIG_GOLIOTH_SAMPLE_TWISTER_TEST=y
      - arch:posix:CONFIG_NATIVE_UART_0_ON_STDINOUT=y
    platform_allow:
      - esp32s3_devkitc/esp32s3/procpu
      - frdm_rw612
      - native_sim
      - native_sim/native/64
      - nrf9160dk/nrf9160/ns
      - nucleo_h563zi/stm32h563xx
  sample.golioth.lightdb_get.wifi:
    harness: pytest
    tags:
      - golioth
      - lightdb
      - socket
      - goliothd
    timeout: 180
    extra_configs:
      - CONFIG_GOLIOTH_SAMPLE_TWISTER_TEST=y
    extra_args:
      - EXTRA_CONF_FILE=boards/frdm_rw612_wifi.conf
    platform_allow:
      - frdm_rw612
```

## prj.conf
```kconfig
# Application
CONFIG_GOLIOTH_SAMPLE_COMMON=y
CONFIG_GOLIOTH_SAMPLE_HARDCODED_CREDENTIALS=y

# Golioth Firmware SDK with all dependencies
CONFIG_GOLIOTH_FIRMWARE_SDK=y

CONFIG_FLASH=y
CONFIG_FLASH_MAP=y
CONFIG_STREAM_FLASH=y
CONFIG_IMG_MANAGER=y

CONFIG_GOLIOTH_SAMPLE_PSK_ID="devboard-one-id@ttgo-demo"
CONFIG_GOLIOTH_SAMPLE_PSK="my_password"
```

## boards/frdm_rw612_wifi.conf
```kconfig
# Extra configuration file for using NXP frdm_rw612 with WiFi instead of Ethernet
#   To use, add as extra conf file:
#   west build -p -b frdm_rw612 examples/zephyr/lightdb/get --extra-conf boards/frdm_rw612_wifi.conf
#
CONFIG_WIFI=y
CONFIG_WIFI_NXP=y
CONFIG_GOLIOTH_SAMPLE_WIFI=y

# Runtime provisioning for WiFi credentials
CONFIG_WIFI_CREDENTIALS=y
CONFIG_NET_L2_WIFI_SHELL=y
CONFIG_SHELL_STACK_SIZE=2560

# Wifi Configuration
CONFIG_NET_L2_ETHERNET=y
CONFIG_NET_PKT_RX_COUNT=36
CONFIG_NET_PKT_TX_COUNT=36
CONFIG_NET_BUF_RX_COUNT=40
CONFIG_NET_BUF_TX_COUNT=40
CONFIG_NET_BUF_DATA_SIZE=1744

# Handle WiFi Networks with Multiple DNS Servers
CONFIG_DNS_RESOLVER_MAX_SERVERS=3

# Disable Ethernet
CONFIG_ETH_NXP_ENET=n
CONFIG_PHY_MICROCHIP_KSZ8081=n
CONFIG_NET_CONFIG_AUTO_INIT=n
CONFIG_NET_CONFIG_NEED_IPV4=n

CONFIG_ZVFS_POLL_MAX=4
```

## src/main.c
```c
/*
 * Copyright (c) 2023 Golioth, Inc.
 *
 * SPDX-License-Identifier: Apache-2.0
 */

#include <zephyr/logging/log.h>
LOG_MODULE_REGISTER(lightdb_get, LOG_LEVEL_DBG);

#include <golioth/client.h>
#include <golioth/lightdb_state.h>
#include <golioth/payload_utils.h>
#include <golioth/zcbor_utils.h>
#include <samples/common/sample_credentials.h>
#include <string.h>
#include <zcbor_decode.h>
#include <zephyr/kernel.h>

#include <samples/common/net_connect.h>

#define APP_TIMEOUT_S 5

struct golioth_client *client;
static K_SEM_DEFINE(connected, 0, 1);

static void on_client_event(struct golioth_client *client,
                            enum golioth_client_event event,
                            void *arg)
{
    bool is_connected = (event == GOLIOTH_CLIENT_EVENT_CONNECTED);
    if (is_connected)
    {
        k_sem_give(&connected);
    }
    LOG_INF("Golioth client %s", is_connected ? "connected" : "disconnected");
}

static void counter_get_handler(struct golioth_client *client,
                                enum golioth_status status,
                                const struct golioth_coap_rsp_code *coap_rsp_code,
                                const char *path,
                                const uint8_t *payload,
                                size_t payload_size,
                                void *arg)
{
    if ((status != GOLIOTH_OK) || golioth_payload_is_null(payload, payload_size))
    {
        LOG_WRN("Failed to get counter: %d (%s)", status, golioth_status_to_str(status));
    }
    else
    {
        LOG_INF("Counter: %d", golioth_payload_as_int(payload, payload_size));
    }
}

static void counter_get(struct golioth_client *client)
{
    int err;

    err = golioth_lightdb_get(client,
                              "counter",
                              GOLIOTH_CONTENT_TYPE_JSON,
                              counter_get_handler,
                              NULL);
    if (err)
    {
        LOG_WRN("failed to get data from LightDB: %d (%s)", err, golioth_status_to_str(err));
    }
}

static void counter_get_json_handler(struct golioth_client *client,
                                     enum golioth_status status,
                                     const struct golioth_coap_rsp_code *coap_rsp_code,
                                     const char *path,
                                     const uint8_t *payload,
                                     size_t payload_size,
                                     void *arg)
{
    if ((GOLIOTH_OK != status) || golioth_payload_is_null(payload, payload_size))
    {
        LOG_ERR("Error fetching LightDB JSON: %d (%s)", status, golioth_status_to_str(status));
    }
    else
    {
        char sbuf[128];
        snprintf(sbuf, sizeof(sbuf), "LightDB JSON: %.*s", (int) payload_size, payload);
        LOG_INF("LightDB JSON: %s", payload);
    }
}

static void counter_get_json(struct golioth_client *client)
{
    /* Get root of LightDB State, but JSON can be returned for any path */
    enum golioth_status status =
        golioth_lightdb_get(client, "", GOLIOTH_CONTENT_TYPE_JSON, counter_get_json_handler, NULL);
    if (GOLIOTH_OK != status)
    {
        LOG_ERR("failed to get JSON data from LightDB: %d (%s)",
                status,
                golioth_status_to_str(status));
    }
}

static void counter_get_cbor_handler(struct golioth_client *client,
                                     enum golioth_status status,
                                     const struct golioth_coap_rsp_code *coap_rsp_code,
                                     const char *path,
                                     const uint8_t *payload,
                                     size_t payload_size,
                                     void *arg)
{
    if ((status != GOLIOTH_OK) || golioth_payload_is_null(payload, payload_size))
    {
        LOG_WRN("Failed to get counter: %d (%s)", status, golioth_status_to_str(status));
        return;
    }

    ZCBOR_STATE_D(zsd, 1, payload, payload_size, 1, 0);
    int64_t counter;
    struct zcbor_map_entry map_entry =
        ZCBOR_TSTR_LIT_MAP_ENTRY("counter", zcbor_map_int64_decode, &counter);

    int err = zcbor_map_decode(zsd, &map_entry, 1);
    if (err)
    {
        LOG_WRN("Failed to decode CBOR data: %d", err);
    }

    LOG_INF("Counter (CBOR): %d", (uint32_t) counter);
}

static void counter_get_cbor(struct golioth_client *client)
{
    int err =
        golioth_lightdb_get(client, "", GOLIOTH_CONTENT_TYPE_CBOR, counter_get_cbor_handler, NULL);
    if (err)
    {
        LOG_WRN("Failed to get data from LightDB: %d (%s)", err, golioth_status_to_str(err));
    }
}

int main(void)
{
    LOG_DBG("Start LightDB get sample");

    net_connect();

    /* Note: In production, credentials should be saved in secure storage. For
     * simplicity, we provide a utility that stores credentials as plaintext
     * settings.
     */
    const struct golioth_client_config *client_config = golioth_sample_credentials_get();

    client = golioth_client_create(client_config);
    golioth_client_register_event_callback(client, on_client_event, NULL);

    k_sem_take(&connected, K_FOREVER);

    while (true)
    {
        LOG_INF("Before request");
        counter_get(client);
        LOG_INF("After request");

        k_sleep(K_SECONDS(5));

        LOG_INF("Before JSON request");
        counter_get_json(client);
        LOG_INF("After JSON request");

        k_sleep(K_SECONDS(5));

        LOG_INF("Before CBOR request");
        counter_get_cbor(client);
        LOG_INF("After CBOR request");

        k_sleep(K_SECONDS(5));
    }

    return 0;
}
```
