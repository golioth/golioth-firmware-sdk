## CMakeLists.txt
```
# SPDX-License-Identifier: Apache-2.0

cmake_minimum_required(VERSION 3.20.0)

find_package(Zephyr REQUIRED HINTS $ENV{ZEPHYR_BASE})
project(settings)

target_sources(app PRIVATE src/main.c)
```

## sample.yaml
```
sample:
  description: Golioth Settings Sample
  name: settings
common:
  harness: pytest
  tags:
    - golioth
    - socket
    - goliothd
tests:
  sample.golioth.settings:
    timeout: 180
    extra_configs:
      - CONFIG_GOLIOTH_SAMPLE_TWISTER_TEST=y
      - arch:posix:CONFIG_NATIVE_UART_0_ON_STDINOUT=y
    platform_allow:
      - esp32s3_devkitc/esp32s3/procpu
      - frdm_rw612
      - native_sim
      - native_sim/native/64
      - nrf9160dk/nrf9160/ns
      - nucleo_h563zi/stm32h563xx
  sample.golioth.settings.wifi:
    harness: pytest
    tags:
      - golioth
      - socket
      - goliothd
    timeout: 180
    extra_configs:
      - CONFIG_GOLIOTH_SAMPLE_TWISTER_TEST=y
    extra_args:
      - EXTRA_CONF_FILE=boards/frdm_rw612_wifi.conf
    platform_allow:
      - frdm_rw612
```

## prj.conf
```kconfig
# Application
CONFIG_GOLIOTH_SAMPLE_COMMON=y
CONFIG_LOG_BACKEND_GOLIOTH=y

# Golioth Firmware SDK with all dependencies
CONFIG_GOLIOTH_FIRMWARE_SDK=y
CONFIG_GOLIOTH_SETTINGS=y
```

## boards/esp32_devkitc_wrover.conf
```kconfig
CONFIG_WIFI=y
CONFIG_HEAP_MEM_POOL_SIZE=98304

CONFIG_NET_L2_ETHERNET=y

CONFIG_NEWLIB_LIBC=y

CONFIG_NET_DHCPV4=y

CONFIG_MBEDTLS_ENTROPY_ENABLED=y
CONFIG_MBEDTLS_KEY_EXCHANGE_ECDHE_ECDSA_ENABLED=y
CONFIG_MBEDTLS_ECP_ALL_ENABLED=y

CONFIG_ESP32_WIFI_STA_AUTO_DHCPV4=y

CONFIG_NET_L2_WIFI_SHELL=y
CONFIG_GOLIOTH_SAMPLE_WIFI=y
```

## boards/frdm_rw612_wifi.conf
```kconfig
# Extra configuration file for using NXP frdm_rw612 with WiFi instead of Ethernet
#   To use, add as extra conf file:
#   west build -p -b frdm_rw612 examples/zephyr/settings --extra-conf boards/frdm_rw612_wifi.conf
#
CONFIG_WIFI=y
CONFIG_WIFI_NXP=y
CONFIG_GOLIOTH_SAMPLE_WIFI=y

# Runtime provisioning for WiFi credentials
CONFIG_WIFI_CREDENTIALS=y
CONFIG_NET_L2_WIFI_SHELL=y
CONFIG_SHELL_STACK_SIZE=2560

# Wifi Configuration
CONFIG_NET_L2_ETHERNET=y
CONFIG_NET_PKT_RX_COUNT=36
CONFIG_NET_PKT_TX_COUNT=36
CONFIG_NET_BUF_RX_COUNT=40
CONFIG_NET_BUF_TX_COUNT=40
CONFIG_NET_BUF_DATA_SIZE=1744

# Handle WiFi Networks with Multiple DNS Servers
CONFIG_DNS_RESOLVER_MAX_SERVERS=3

# Disable Ethernet
CONFIG_ETH_NXP_ENET=n
CONFIG_PHY_MICROCHIP_KSZ8081=n
CONFIG_NET_CONFIG_AUTO_INIT=n
CONFIG_NET_CONFIG_NEED_IPV4=n

CONFIG_ZVFS_POLL_MAX=4
```

## boards/nrf52840dk_nrf52840.conf
```kconfig
CONFIG_NET_PKT_TX_COUNT=8
```

## src/main.c
```c
/*
 * Copyright (c) 2023 Golioth, Inc.
 *
 * SPDX-License-Identifier: Apache-2.0
 */

#include <zephyr/logging/log.h>
LOG_MODULE_REGISTER(device_settings, LOG_LEVEL_DBG);

#include <golioth/client.h>
#include <golioth/settings.h>
#include <samples/common/sample_credentials.h>
#include <zephyr/kernel.h>

#include <samples/common/net_connect.h>

// Define min and max acceptable values for setting
#define LOOP_DELAY_S_MIN 1
#define LOOP_DELAY_S_MAX 300

// Configurable via Settings service, key = "LOOP_DELAY_S"
int32_t _loop_delay_s = 10;

static K_SEM_DEFINE(connected, 0, 1);

static enum golioth_settings_status on_loop_delay_setting(int32_t new_value, void *arg)
{
    LOG_INF("Setting loop delay to %" PRId32 " s", new_value);
    _loop_delay_s = new_value;
    return GOLIOTH_SETTINGS_SUCCESS;
}

static void on_client_event(struct golioth_client *client,
                            enum golioth_client_event event,
                            void *arg)
{
    bool is_connected = (event == GOLIOTH_CLIENT_EVENT_CONNECTED);
    if (is_connected)
    {
        k_sem_give(&connected);
    }
    LOG_INF("Golioth client %s", is_connected ? "connected" : "disconnected");
}

int main(void)
{
    int counter = 0;

    LOG_DBG("Start Golioth Device Settings sample");

    net_connect();

    /* Note: In production, credentials should be saved in secure storage. For
     * simplicity, we provide a utility that stores credentials as plaintext
     * settings.
     */
    const struct golioth_client_config *client_config = golioth_sample_credentials_get();

    struct golioth_client *client = golioth_client_create(client_config);

    golioth_client_register_event_callback(client, on_client_event, NULL);

    struct golioth_settings *settings = golioth_settings_init(client);

    golioth_settings_register_int_with_range(settings,
                                             "LOOP_DELAY_S",
                                             LOOP_DELAY_S_MIN,
                                             LOOP_DELAY_S_MAX,
                                             on_loop_delay_setting,
                                             NULL);

    k_sem_take(&connected, K_FOREVER);

    while (true)
    {
        LOG_INF("Sending hello! %d", counter);

        ++counter;
        k_sleep(K_SECONDS(_loop_delay_s));
    }

    return 0;
}
```
