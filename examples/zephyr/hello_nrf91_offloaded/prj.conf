## CMakeLists.txt
```
# SPDX-License-Identifier: Apache-2.0

cmake_minimum_required(VERSION 3.20.0)

find_package(Zephyr REQUIRED HINTS $ENV{ZEPHYR_BASE})
project(hello_nrf91_offloaded)

target_sources(app PRIVATE src/main.c src/nrf_modem_at_shell.c)
```

## sample.yaml
```
sample:
  description: Say Hello to Golioth server using nRF91 offloaded DTLS sockets
  name: hello_nrf91_offloaded
tests:
  sample.golioth.hello_nrf91_offloaded:
    harness: pytest
    tags:
      - golioth
      - socket
      - goliothd
    timeout: 180
    extra_configs:
      - CONFIG_GOLIOTH_SAMPLE_NRF91_RESET_LOOP_OVERRIDE=y
      - CONFIG_SHELL_DEFAULT_TERMINAL_WIDTH=160
    platform_allow: nrf9160dk/nrf9160/ns
```

## prj.conf
```kconfig
# Application
CONFIG_GOLIOTH_SAMPLE_COMMON=y
CONFIG_GOLIOTH_SAMPLE_AUTH_TYPE_TAG=y
CONFIG_LOG_BACKEND_GOLIOTH=y

# Golioth Firmware SDK with all dependencies
CONFIG_GOLIOTH_FIRMWARE_SDK=y

# General config
CONFIG_HEAP_MEM_POOL_SIZE=4096
CONFIG_NEWLIB_LIBC=y

# Networking
CONFIG_NET_SOCKETS_OFFLOAD=y
CONFIG_NET_IPV6=y
CONFIG_NET_IPV6_NBR_CACHE=n
CONFIG_NET_IPV6_MLD=n

# Modem library
CONFIG_NRF_MODEM_LIB=y

# LTE connectivity with network connection manager
CONFIG_NRF_MODEM_LIB_NET_IF=y
CONFIG_NRF_MODEM_LIB_NET_IF_AUTO_START=y
CONFIG_NRF_MODEM_LIB_NET_IF_AUTO_CONNECT=y
CONFIG_NET_CONNECTION_MANAGER=y
CONFIG_NET_CONNECTION_MANAGER_MONITOR_STACK_SIZE=1024

# Increased sysworkq size, due to LTE connectivity
CONFIG_SYSTEM_WORKQUEUE_STACK_SIZE=2048

# Disable options y-selected by NCS for no good reason
CONFIG_MBEDTLS_KEY_EXCHANGE_DHE_PSK_ENABLED=n
CONFIG_MBEDTLS_KEY_EXCHANGE_DHE_RSA_ENABLED=n
CONFIG_MBEDTLS_PK_PARSE_EC_EXTENDED=n

# MbedTLS configuration to support p-384 curve. These options
# enable using the MbedTLS built-in support for operations not
# supported by the default nRF Oberon crypto backend
CONFIG_NORDIC_SECURITY_BACKEND=n
CONFIG_MBEDTLS_LEGACY_CRYPTO_C=y

# Generate MCUboot compatible images
CONFIG_BOOTLOADER_MCUBOOT=y
```

## src/main.c
```c
/*
 * Copyright (c) 2023-2024 Golioth, Inc.
 *
 * SPDX-License-Identifier: Apache-2.0
 */

#include <zephyr/logging/log.h>
LOG_MODULE_REGISTER(hello_zephyr, LOG_LEVEL_DBG);

#include <golioth/client.h>
#include <samples/common/sample_credentials.h>
#include <string.h>
#include <zephyr/kernel.h>

#include <samples/common/net_connect.h>

struct golioth_client *client;
static K_SEM_DEFINE(connected, 0, 1);

static void on_client_event(struct golioth_client *client,
                            enum golioth_client_event event,
                            void *arg)
{
    bool is_connected = (event == GOLIOTH_CLIENT_EVENT_CONNECTED);
    if (is_connected)
    {
        k_sem_give(&connected);
    }
    LOG_INF("Golioth client %s", is_connected ? "connected" : "disconnected");
}

int main(void)
{
    int counter = 0;

    LOG_DBG("start hello sample");

    net_connect();

    /* Note: This tag must match the one used to provision credentials */
    const struct golioth_client_config client_config = {
        .credentials =
            {
                .auth_type = GOLIOTH_TLS_AUTH_TYPE_TAG,
                .tag = CONFIG_GOLIOTH_COAP_CLIENT_CREDENTIALS_TAG,
            },
    };

    client = golioth_client_create(&client_config);

    golioth_client_register_event_callback(client, on_client_event, NULL);

    k_sem_take(&connected, K_FOREVER);

    while (true)
    {
        LOG_INF("Sending hello! %d", counter);

        ++counter;
        k_sleep(K_SECONDS(5));
    }

    return 0;
}
```

## src/nrf_modem_at_shell.c
```c
/*
 * Copyright (c) 2023-2024 Golioth, Inc.
 *
 * SPDX-License-Identifier: Apache-2.0
 */

#include <zephyr/shell/shell.h>
#include <nrf_modem_at.h>

static char at_resp_buf[2048];

static int cmd_at(const struct shell *sh, size_t argc, char **argv)
{
    int err;

    if (argc < 2)
    {
        shell_help(sh);
        return -EINVAL;
    }

    err = nrf_modem_at_cmd(at_resp_buf, sizeof(at_resp_buf), "%s", argv[1]);
    if (err)
    {
        shell_error(sh, "Failed with error: %d", err);
        return err;
    }

    shell_print(sh, "%s", at_resp_buf);

    return 0;
}

SHELL_CMD_REGISTER(nrf_modem_at, NULL, "nrf_modem_at <bypassed_at_cmd>", cmd_at);
```
