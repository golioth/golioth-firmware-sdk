## CMakeLists.txt
```
# SPDX-License-Identifier: Apache-2.0

cmake_minimum_required(VERSION 3.20.0)

if(BOARD STREQUAL "nrf52840dk/nrf52840")
    if(NOT SHIELD)
        set(SHIELD golioth_esp_at)
        message(WARNING
            "Implicitly selecting golioth_esp_at SHIELD. This behavior is\
             deprecated. Specify '--shield golioth_esp_at' explicitly with\
             'west build' invocation.")
    endif()
endif()

find_package(Zephyr REQUIRED HINTS $ENV{ZEPHYR_BASE})
project(logging)

target_sources(app PRIVATE src/main.c)
```

## Kconfig
```
# Copyright (c) 2023 Golioth, Inc.
# SPDX-License-Identifier: Apache-2.0

source "${ZEPHYR_GOLIOTH_FIRMWARE_SDK_MODULE_DIR}/examples/zephyr/common/Kconfig.defconfig"

source "Kconfig.zephyr"
```

## sample.yaml
```
sample:
  description: System logging to Golioth server
  name: logging
common:
  harness: pytest
  tags:
    - golioth
    - logger
    - socket
    - goliothd
tests:
  sample.golioth.logging:
    timeout: 180
    extra_configs:
      - CONFIG_GOLIOTH_SAMPLE_TWISTER_TEST=y
      - arch:posix:CONFIG_NATIVE_UART_0_ON_STDINOUT=y
    platform_allow:
      - esp32s3_devkitc/esp32s3/procpu
      - frdm_rw612
      - native_sim
      - native_sim/native/64
      - nrf9160dk/nrf9160/ns
      - nucleo_h563zi/stm32h563xx
  sample.golioth.logging.wifi:
    harness: pytest
    tags:
      - golioth
      - logger
      - socket
      - goliothd
    timeout: 180
    extra_configs:
      - CONFIG_GOLIOTH_SAMPLE_TWISTER_TEST=y
    extra_args:
      - EXTRA_CONF_FILE=boards/frdm_rw612_wifi.conf
    platform_allow:
      - frdm_rw612
```

## prj.conf
```kconfig
# Application
CONFIG_GOLIOTH_SAMPLE_COMMON=y
CONFIG_GOLIOTH_SAMPLE_HARDCODED_CREDENTIALS=y
CONFIG_LOG_BACKEND_GOLIOTH=y

# Golioth Firmware SDK with all dependencies
CONFIG_GOLIOTH_FIRMWARE_SDK=y
```

## boards/frdm_rw612_wifi.conf
```kconfig
# Extra configuration file for using NXP frdm_rw612 with WiFi instead of Ethernet
#   To use, add as extra conf file:
#   west build -p -b frdm_rw612 examples/zephyr/logging --extra-conf boards/frdm_rw612_wifi.conf
#
CONFIG_WIFI=y
CONFIG_WIFI_NXP=y
CONFIG_GOLIOTH_SAMPLE_WIFI=y

# Runtime provisioning for WiFi credentials
CONFIG_WIFI_CREDENTIALS=y
CONFIG_NET_L2_WIFI_SHELL=y
CONFIG_SHELL_STACK_SIZE=2560

# Wifi Configuration
CONFIG_NET_L2_ETHERNET=y
CONFIG_NET_PKT_RX_COUNT=36
CONFIG_NET_PKT_TX_COUNT=36
CONFIG_NET_BUF_RX_COUNT=40
CONFIG_NET_BUF_TX_COUNT=40
CONFIG_NET_BUF_DATA_SIZE=1744

# Handle WiFi Networks with Multiple DNS Servers
CONFIG_DNS_RESOLVER_MAX_SERVERS=3

# Disable Ethernet
CONFIG_ETH_NXP_ENET=n
CONFIG_PHY_MICROCHIP_KSZ8081=n
CONFIG_NET_CONFIG_AUTO_INIT=n
CONFIG_NET_CONFIG_NEED_IPV4=n

CONFIG_ZVFS_POLL_MAX=4
```

## boards/native_sim.conf
```kconfig
# Use offloaded sockets using host BSD sockets
CONFIG_ETH_DRIVER=n
CONFIG_ETH_NATIVE_POSIX=n
CONFIG_NET_DRIVERS=y
CONFIG_NET_SOCKETS=y
CONFIG_NET_SOCKETS_OFFLOAD=y
CONFIG_NET_NATIVE_OFFLOADED_SOCKETS=y
CONFIG_HEAP_MEM_POOL_SIZE=1024

# Use embedded libc to use Zephyr's eventfd instead of host eventfd
CONFIG_PICOLIBC=y

# Static networking
CONFIG_NET_CONFIG_LOG_LEVEL_DBG=y
CONFIG_NET_CONFIG_SETTINGS=y
CONFIG_NET_CONFIG_NEED_IPV4=y
CONFIG_NET_CONFIG_MY_IPV4_ADDR="192.0.2.1"
CONFIG_NET_CONFIG_MY_IPV4_GW="192.0.2.2"
CONFIG_NET_CONFIG_PEER_IPV4_ADDR="192.0.2.2"

# Disabled shell for using standard output
CONFIG_NET_SHELL=n
CONFIG_SHELL=n

# Golioth logging backend requirement
CONFIG_LOG_MODE_DEFERRED=y
```

## boards/nrf52840dk_nrf52840.conf
```kconfig
CONFIG_WIFI=y
CONFIG_WIFI_ESP_AT=y
CONFIG_WIFI_ESP_AT_MDM_RX_BUF_COUNT=40
CONFIG_WIFI_ESP_AT_CIPDINFO_USE=y
CONFIG_WIFI_ESP_AT_DNS_USE=y

CONFIG_NET_L2_WIFI_SHELL=y
CONFIG_GOLIOTH_SAMPLE_WIFI=y

CONFIG_NET_PKT_TX_COUNT=12
CONFIG_NET_BUF_TX_COUNT=24
```

## boards/rak5010_nrf52840.conf
```kconfig
CONFIG_UART_ASYNC_API=y
CONFIG_MODEM_CELLULAR_APN="internet"

# USB
CONFIG_USB_DEVICE_STACK_NEXT=y
CONFIG_USBD_CDC_ACM_CLASS=y
CONFIG_CDC_ACM_SERIAL_PID=0x0004
CONFIG_CDC_ACM_SERIAL_PRODUCT_STRING="RAK5010 Zephyr"
CONFIG_CDC_ACM_SERIAL_INITIALIZE_AT_BOOT=y

CONFIG_UART_CONSOLE=y
CONFIG_UART_LINE_CTRL=y
CONFIG_LOG_BACKEND_RTT=n
CONFIG_USBD_LOG_LEVEL_OFF=y
CONFIG_USBD_CDC_ACM_LOG_LEVEL_OFF=y
CONFIG_UDC_DRIVER_LOG_LEVEL_OFF=y

# Networking
CONFIG_NETWORKING=y
CONFIG_NET_NATIVE=y
CONFIG_NET_L2_PPP=y
CONFIG_NET_IPV4=y
CONFIG_NET_UDP=y
CONFIG_NET_SOCKETS=y
CONFIG_NET_CONTEXT_RCVTIMEO=y

# Modem driver
CONFIG_MODEM=y
CONFIG_MODEM_CELLULAR=y
CONFIG_MODEM_CMUX_WORK_BUFFER_SIZE=1024
```

## socs/native_64.conf
```kconfig
# Use offloaded sockets using host BSD sockets
CONFIG_ETH_DRIVER=n
CONFIG_ETH_NATIVE_POSIX=n
CONFIG_NET_DRIVERS=y
CONFIG_NET_SOCKETS=y
CONFIG_NET_SOCKETS_OFFLOAD=y
CONFIG_NET_NATIVE_OFFLOADED_SOCKETS=y

# Use embedded libc to use Zephyr's eventfd instead of host eventfd
CONFIG_PICOLIBC=y

# Static networking
CONFIG_NET_CONFIG_LOG_LEVEL_DBG=y
CONFIG_NET_CONFIG_SETTINGS=y
CONFIG_NET_CONFIG_NEED_IPV4=y
CONFIG_NET_CONFIG_MY_IPV4_ADDR="192.0.2.1"
CONFIG_NET_CONFIG_MY_IPV4_GW="192.0.2.2"
CONFIG_NET_CONFIG_PEER_IPV4_ADDR="192.0.2.2"

# Golioth logging backend requirement
CONFIG_LOG_MODE_DEFERRED=y
```

## socs/nrf9160_ns.conf
```kconfig
# General config
CONFIG_HEAP_MEM_POOL_SIZE=4096
CONFIG_NEWLIB_LIBC=y

# Networking
CONFIG_NET_SOCKETS_OFFLOAD=y
CONFIG_NET_IPV6=y
CONFIG_NET_IPV6_NBR_CACHE=n
CONFIG_NET_IPV6_MLD=n

# Increase native TLS socket implementation, so that it is chosen instead of
# offloaded nRF91 sockets
CONFIG_NET_SOCKETS_TLS_PRIORITY=35

# Modem library
CONFIG_NRF_MODEM_LIB=y

# LTE connectivity with network connection manager
CONFIG_NRF_MODEM_LIB_NET_IF=y
CONFIG_NRF_MODEM_LIB_NET_IF_AUTO_START=y
CONFIG_NRF_MODEM_LIB_NET_IF_AUTO_CONNECT=y
CONFIG_NET_CONNECTION_MANAGER=y
CONFIG_NET_CONNECTION_MANAGER_MONITOR_STACK_SIZE=1024

# Increased sysworkq size, due to LTE connectivity
CONFIG_SYSTEM_WORKQUEUE_STACK_SIZE=2048

# Disable options y-selected by NCS for no good reason
CONFIG_MBEDTLS_KEY_EXCHANGE_DHE_PSK_ENABLED=n
CONFIG_MBEDTLS_KEY_EXCHANGE_DHE_RSA_ENABLED=n
CONFIG_MBEDTLS_PK_PARSE_EC_EXTENDED=n

# MbedTLS configuration to support p-384 curve. These options
# enable using the MbedTLS built-in support for operations not
# supported by the default nRF Oberon crypto backend
CONFIG_NORDIC_SECURITY_BACKEND=n
CONFIG_MBEDTLS_LEGACY_CRYPTO_C=y

# Generate MCUboot compatible images
CONFIG_BOOTLOADER_MCUBOOT=y
```

## src/main.c
```c
/*
 * Copyright (c) 2023 Golioth, Inc.
 *
 * SPDX-License-Identifier: Apache-2.0
 */

#include <zephyr/logging/log.h>
LOG_MODULE_REGISTER(golioth_logging, LOG_LEVEL_DBG);

#include <golioth/client.h>
#include <samples/common/sample_credentials.h>
#include <string.h>
#include <zephyr/sys/byteorder.h>
#include <zephyr/kernel.h>

#include <samples/common/net_connect.h>

struct golioth_client *client;
static K_SEM_DEFINE(connected, 0, 1);

static void on_client_event(struct golioth_client *client,
                            enum golioth_client_event event,
                            void *arg)
{
    bool is_connected = (event == GOLIOTH_CLIENT_EVENT_CONNECTED);
    if (is_connected)
    {
        k_sem_give(&connected);
    }
    LOG_INF("Golioth client %s", is_connected ? "connected" : "disconnected");
}

static void func_1(int counter)
{
    LOG_DBG("Log 1: %d", counter);
}

static void func_2(int counter)
{
    LOG_DBG("Log 2: %d", counter);
}

int main(void)
{
    int counter = 0;

    LOG_DBG("start logging sample");

    net_connect();

    /* Note: In production, credentials should be saved in secure storage. For
     * simplicity, we provide a utility that stores credentials as plaintext
     * settings.
     */
    const struct golioth_client_config *client_config = golioth_sample_credentials_get();

    client = golioth_client_create(client_config);

    golioth_client_register_event_callback(client, on_client_event, NULL);

    k_sem_take(&connected, K_FOREVER);

    while (true)
    {
        LOG_DBG("Debug info! %d", counter);
        func_1(counter);
        func_2(counter);
        LOG_WRN("Warn: %d", counter);
        LOG_ERR("Err: %d", counter);

        /* Ensure a known endian-ness for the counter value */
        uint32_t counter_be = sys_cpu_to_be32(counter);
        LOG_HEXDUMP_INF(&counter_be, sizeof(counter_be), "Counter hexdump");

        counter++;

        k_sleep(K_SECONDS(5));
    }

    return 0;
}
```
