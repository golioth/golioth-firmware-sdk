## CMakeLists.txt
```
# SPDX-License-Identifier: Apache-2.0

cmake_minimum_required(VERSION 3.20.0)

if(BOARD STREQUAL "nrf52840dk/nrf52840")
    if(NOT SHIELD)
        set(SHIELD golioth_esp_at)
        message(WARNING
            "Implicitly selecting golioth_esp_at SHIELD. This behavior is\
             deprecated. Specify '--shield golioth_esp_at' explicitly with\
             'west build' invocation.")
    endif()
endif()

find_package(Zephyr REQUIRED HINTS $ENV{ZEPHYR_BASE})
project(location)

target_sources(app PRIVATE src/main.c)
target_sources_ifdef(CONFIG_GOLIOTH_CELLULAR_PLAYBACK app PRIVATE src/cellular_playback.c)
target_sources_ifdef(CONFIG_GOLIOTH_WIFI_PLAYBACK app PRIVATE src/wifi_playback.c)
target_sources_ifdef(CONFIG_SOC_SERIES_NRF91X app PRIVATE src/cellular_nrf91.c)
```

## Kconfig
```
# Copyright (c) 2021-2025 Golioth, Inc.
# SPDX-License-Identifier: Apache-2.0

configdefault GOLIOTH_NET_INFO_CELLULAR
    default y if SOC_SERIES_NRF91X
    default y if GOLIOTH_CELLULAR_PLAYBACK

configdefault GOLIOTH_NET_INFO_WIFI
    default y if WIFI

configdefault WIFI
    default y if GOLIOTH_WIFI_PLAYBACK

configdefault WIFI_ESP_AT_SCAN_MAC_ADDRESS
	default y

configdefault WIFI_ESP_AT_SCAN_RESULT_RSSI_ORDERED
	default y

source "${ZEPHYR_GOLIOTH_FIRMWARE_SDK_MODULE_DIR}/examples/zephyr/common/Kconfig.defconfig"

config APP_LOCATION_GET_INTERVAL
    int "Interval (msec)"
    default 0 if GOLIOTH_CELLULAR_PLAYBACK || GOLIOTH_WIFI_PLAYBACK
    default 5000
    help
      Interval (msec) between requests of location information.

config GOLIOTH_CELLULAR_PLAYBACK
    bool "Cellular playback"
    default y
    depends on DT_HAS_GOLIOTH_CELLULAR_PLAYBACK_ENABLED

config GOLIOTH_WIFI_PLAYBACK
    bool "WiFi playback"
    default y
    depends on DT_HAS_GOLIOTH_WIFI_PLAYBACK_ENABLED

if GOLIOTH_CELLULAR_PLAYBACK || GOLIOTH_WIFI_PLAYBACK

config GOLIOTH_PLAYBACK_SPEED_FACTOR
    int "Speed factor"
    default 1000
    help
      Speed of playback.

      1000 means 1x (normal) speed.
      3000 means 3x speed.
      500 means 0.5x speed.

endif # GOLIOTH_CELLULAR_PLAYBACK || GOLIOTH_WIFI_PLAYBACK

source "Kconfig.zephyr"
```

## sample.yaml
```
sample:
  description: Location example
  name: location
common:
  tags:
    - golioth
    - location
    - socket
tests:
  sample.golioth.location:
    build_only: true
    platform_allow:
      - esp32s3_devkitc/esp32s3/procpu
      - native_sim
      - native_sim/native/64
      - nrf9151dk/nrf9151/ns
      - nrf9160dk/nrf9160/ns
  sample.golioth.location.playback:
    timeout: 100
    harness: pytest
    extra_configs:
      - CONFIG_GOLIOTH_SAMPLE_TWISTER_TEST=y
      - arch:posix:CONFIG_NATIVE_UART_0_ON_STDINOUT=y
    platform_allow:
      - native_sim
      - native_sim/native/64
  sample.golioth.location.playback.wifi:
    harness: pytest
    extra_configs:
      - CONFIG_GOLIOTH_SAMPLE_TWISTER_TEST=y
      - arch:posix:CONFIG_NATIVE_UART_0_ON_STDINOUT=y
      - CONFIG_GOLIOTH_CELLULAR_PLAYBACK=n
    platform_allow:
      - native_sim
      - native_sim/native/64
  sample.golioth.location.playback.cellular:
    harness: pytest
    extra_configs:
      - CONFIG_GOLIOTH_SAMPLE_TWISTER_TEST=y
      - arch:posix:CONFIG_NATIVE_UART_0_ON_STDINOUT=y
      - CONFIG_GOLIOTH_WIFI_PLAYBACK=n
    platform_allow:
      - native_sim
      - native_sim/native/64
```

## prj.conf
```kconfig
# Application
CONFIG_GOLIOTH_SAMPLE_COMMON=y

# Golioth Firmware SDK with all dependencies
CONFIG_GOLIOTH_FIRMWARE_SDK=y
CONFIG_GOLIOTH_STREAM=y
CONFIG_GOLIOTH_NET_INFO=y
```

## boards/nrf52840dk_nrf52840.conf
```kconfig
CONFIG_WIFI_ESP_AT_SCAN_MAC_ADDRESS=y
CONFIG_WIFI_ESP_AT_SCAN_RESULT_RSSI_ORDERED=y
```

## socs/native.conf
```kconfig
# Use offloaded sockets using host BSD sockets
CONFIG_ETH_DRIVER=n
CONFIG_ETH_NATIVE_POSIX=n
CONFIG_NET_DRIVERS=y
CONFIG_NET_SOCKETS=y
CONFIG_NET_SOCKETS_OFFLOAD=y
CONFIG_NET_NATIVE_OFFLOADED_SOCKETS=y

# Use embedded libc to use Zephyr's eventfd instead of host eventfd
CONFIG_PICOLIBC=y

# Static networking
CONFIG_NET_CONFIG_LOG_LEVEL_DBG=y
CONFIG_NET_CONFIG_SETTINGS=y
CONFIG_NET_CONFIG_NEED_IPV4=y
CONFIG_NET_CONFIG_MY_IPV4_ADDR="192.0.2.1"
CONFIG_NET_CONFIG_MY_IPV4_GW="192.0.2.2"
CONFIG_NET_CONFIG_PEER_IPV4_ADDR="192.0.2.2"

# WiFi playback
CONFIG_WIFI_OFFLOAD=y
CONFIG_NET_L2_WIFI_MGMT=y
CONFIG_NET_IF_MAX_IPV4_COUNT=2
```

## socs/nrf9151_ns.conf
```kconfig
# General config
CONFIG_HEAP_MEM_POOL_SIZE=4096
CONFIG_NEWLIB_LIBC=y

# Networking
CONFIG_NET_SOCKETS_OFFLOAD=y
CONFIG_NET_IPV6=y
CONFIG_NET_IPV6_NBR_CACHE=n
CONFIG_NET_IPV6_MLD=n

# Increase native TLS socket implementation, so that it is chosen instead of
# offloaded nRF91 sockets
CONFIG_NET_SOCKETS_TLS_PRIORITY=35

# Modem library
CONFIG_NRF_MODEM_LIB=y

# LTE connectivity with network connection manager
CONFIG_NRF_MODEM_LIB_NET_IF=y
CONFIG_NRF_MODEM_LIB_NET_IF_AUTO_START=y
CONFIG_NRF_MODEM_LIB_NET_IF_AUTO_CONNECT=y
CONFIG_NET_CONNECTION_MANAGER=y
CONFIG_NET_CONNECTION_MANAGER_MONITOR_STACK_SIZE=1024

# Increased sysworkq size, due to LTE connectivity
CONFIG_SYSTEM_WORKQUEUE_STACK_SIZE=2048

# Disable options y-selected by NCS for no good reason
CONFIG_MBEDTLS_KEY_EXCHANGE_DHE_PSK_ENABLED=n
CONFIG_MBEDTLS_KEY_EXCHANGE_DHE_RSA_ENABLED=n
CONFIG_MBEDTLS_PK_PARSE_EC_EXTENDED=n

# MbedTLS configuration to support p-384 curve. These options
# enable using the MbedTLS built-in support for operations not
# supported by the default nRF Oberon crypto backend
CONFIG_NORDIC_SECURITY_BACKEND=n
CONFIG_MBEDTLS_LEGACY_CRYPTO_C=y

# Generate MCUboot compatible images
CONFIG_BOOTLOADER_MCUBOOT=y

CONFIG_LTE_LC_NEIGHBOR_CELL_MEAS_MODULE=y
```

## socs/nrf9160_ns.conf
```kconfig
# General config
CONFIG_HEAP_MEM_POOL_SIZE=4096
CONFIG_NEWLIB_LIBC=y

# Networking
CONFIG_NET_SOCKETS_OFFLOAD=y
CONFIG_NET_IPV6=y
CONFIG_NET_IPV6_NBR_CACHE=n
CONFIG_NET_IPV6_MLD=n

# Increase native TLS socket implementation, so that it is chosen instead of
# offloaded nRF91 sockets
CONFIG_NET_SOCKETS_TLS_PRIORITY=35

# Modem library
CONFIG_NRF_MODEM_LIB=y

# LTE connectivity with network connection manager
CONFIG_NRF_MODEM_LIB_NET_IF=y
CONFIG_NRF_MODEM_LIB_NET_IF_AUTO_START=y
CONFIG_NRF_MODEM_LIB_NET_IF_AUTO_CONNECT=y
CONFIG_NET_CONNECTION_MANAGER=y
CONFIG_NET_CONNECTION_MANAGER_MONITOR_STACK_SIZE=1024

# Increased sysworkq size, due to LTE connectivity
CONFIG_SYSTEM_WORKQUEUE_STACK_SIZE=2048

# Disable options y-selected by NCS for no good reason
CONFIG_MBEDTLS_KEY_EXCHANGE_DHE_PSK_ENABLED=n
CONFIG_MBEDTLS_KEY_EXCHANGE_DHE_RSA_ENABLED=n
CONFIG_MBEDTLS_PK_PARSE_EC_EXTENDED=n

# MbedTLS configuration to support p-384 curve. These options
# enable using the MbedTLS built-in support for operations not
# supported by the default nRF Oberon crypto backend
CONFIG_NORDIC_SECURITY_BACKEND=n
CONFIG_MBEDTLS_LEGACY_CRYPTO_C=y

CONFIG_LTE_LC_NEIGHBOR_CELL_MEAS_MODULE=y
```

## socs/native.overlay
```dts
/ {
	cellular-playback {
		compatible = "golioth,cellular-playback";
		status = "okay";
	};

	wifi-playback {
		compatible = "golioth,wifi-playback";
		status = "okay";
	};
};
```

## dts/bindings/modem/golioth,cellular-playback.yaml
```yaml
# Copyright (c) 2025 Golioth, Inc.
# SPDX-License-Identifier: Apache-2.0

description: Cellular driver with playback of scanned cellular networks

compatible: "golioth,cellular-playback"

include: base.yaml
```

## src/main.c
```c
/*
 * Copyright (c) 2024 Golioth, Inc.
 *
 * SPDX-License-Identifier: Apache-2.0
 */

#include <zephyr/logging/log.h>
LOG_MODULE_REGISTER(location_main, LOG_LEVEL_DBG);

#include <golioth/client.h>
#include <golioth/stream.h>
#include <golioth/net_info/cellular.h>
#include <golioth/net_info/wifi.h>
#include <samples/common/sample_credentials.h>
#include <string.h>
#include <zephyr/net/wifi_mgmt.h>

#include <samples/common/net_connect.h>

#include "cellular.h"

struct golioth_client *client;
static K_SEM_DEFINE(connected, 0, 1);

static void on_client_event(struct golioth_client *client,
                            enum golioth_client_event event,
                            void *arg)
{
    bool is_connected = (event == GOLIOTH_CLIENT_EVENT_CONNECTED);
    if (is_connected)
    {
        k_sem_give(&connected);
    }
    LOG_INF("Golioth client %s", is_connected ? "connected" : "disconnected");
}

static enum golioth_status golioth_net_info_wifi_append_zephyr(
    struct golioth_net_info *info,
    const struct wifi_scan_result *result)
{
    struct golioth_wifi_scan_result golioth_result = {
        .mac = {result->mac[0],
                result->mac[1],
                result->mac[2],
                result->mac[3],
                result->mac[4],
                result->mac[5]},
        .rssi = result->rssi,
    };

    return golioth_net_info_wifi_append(info, &golioth_result);
}

static struct golioth_net_info *info;

static int cellular_get_and_encode_info(void)
{
    struct golioth_cellular_info cellular_infos[4];
    enum golioth_status status;
    size_t num_infos;
    int err;

    if (!IS_ENABLED(CONFIG_GOLIOTH_NET_INFO_CELLULAR))
    {
        return 0;
    }

    err = cellular_info_get(cellular_infos, ARRAY_SIZE(cellular_infos), &num_infos);
    if (err)
    {
        LOG_ERR("Failed to get cellular network info: %d", err);
        return err;
    }

    for (size_t i = 0; i < num_infos; i++)
    {
        status = golioth_net_info_cellular_append(info, &cellular_infos[i]);
        if (status != GOLIOTH_OK)
        {
            LOG_ERR("Failed to append cellular info: %d", status);
            return -ENOMEM;
        }
    }

    return 0;
}

static void wifi_scan_result_process(const struct wifi_scan_result *entry)
{
    if (entry->mac_length != WIFI_MAC_ADDR_LEN)
    {
        return;
    }

    golioth_net_info_wifi_append_zephyr(info, entry);
}

static K_SEM_DEFINE(scan_sem, 0, 1);

static void wifi_scan_done_process(void)
{
    k_sem_give(&scan_sem);
}

static void wifi_mgmt_event_handler(struct net_mgmt_event_callback *cb,
                                    uint64_t mgmt_event,
                                    struct net_if *iface)
{
    switch (mgmt_event)
    {
        case NET_EVENT_WIFI_SCAN_RESULT:
            wifi_scan_result_process(cb->info);
            break;
        case NET_EVENT_WIFI_SCAN_DONE:
            wifi_scan_done_process();
            break;
        default:
            break;
    }
}

static int wifi_scan_and_encode_info(struct net_if *iface)
{
    int err;

    if (!IS_ENABLED(CONFIG_GOLIOTH_NET_INFO_WIFI))
    {
        return 0;
    }

    err = net_mgmt(NET_REQUEST_WIFI_SCAN, iface, NULL, 0);
    if (err)
    {
        LOG_ERR("Failed to scan: %d", err);
        return err;
    }

    k_sem_take(&scan_sem, K_FOREVER);

    return 0;
}

struct block_upload_source
{
    const uint8_t *buf;
    size_t len;
};

static enum golioth_status block_upload_read_chunk(uint32_t block_idx,
                                                   uint8_t *block_buffer,
                                                   size_t *block_size,
                                                   bool *is_last,
                                                   void *arg)
{
    size_t bu_max_block_size = *block_size;
    const struct block_upload_source *bu_source = arg;
    size_t bu_offset = block_idx * bu_max_block_size;
    size_t bu_size = bu_source->len - bu_offset;

    if (bu_offset >= bu_source->len)
    {
        GLTH_LOGE(TAG, "Calculated offset is past end of buffer: %zu", bu_offset);
        goto bu_error;
    }

    if (bu_size <= bu_max_block_size)
    {
        *block_size = bu_size;
        *is_last = true;
    }

    GLTH_LOGI(TAG,
              "block-idx: %" PRIu32 " bu_offset: %zu bytes_remaining: %zu",
              block_idx,
              bu_offset,
              bu_size);

    memcpy(block_buffer, bu_source->buf + bu_offset, *block_size);
    return GOLIOTH_OK;

bu_error:
    *block_size = 0;
    *is_last = true;

    return GOLIOTH_ERR_NO_MORE_DATA;
}

static struct net_mgmt_event_callback wifi_mgmt_cb;

int main(void)
{
    struct net_if *wifi_iface = net_if_get_first_wifi();
    enum golioth_status status;
    int err;

    LOG_DBG("Start location sample");

    if (IS_ENABLED(CONFIG_WIFI))
    {
        net_mgmt_init_event_callback(&wifi_mgmt_cb,
                                     wifi_mgmt_event_handler,
                                     (NET_EVENT_WIFI_SCAN_RESULT | NET_EVENT_WIFI_SCAN_DONE));
        net_mgmt_add_event_callback(&wifi_mgmt_cb);
    }

    net_connect();

    /* Note: In production, credentials should be saved in secure storage. For
     * simplicity, we provide a utility that stores credentials as plaintext
     * settings.
     */
    const struct golioth_client_config *client_config = golioth_sample_credentials_get();

    client = golioth_client_create(client_config);
    golioth_client_register_event_callback(client, on_client_event, NULL);

    k_sem_take(&connected, K_FOREVER);

    info = golioth_net_info_create();

    while (true)
    {
        err = cellular_get_and_encode_info();
        if (err)
        {
            LOG_ERR("Failed to encode cellular network information data: %d", err);
            continue;
        }

        err = wifi_scan_and_encode_info(wifi_iface);
        if (err)
        {
            LOG_ERR("Failed to encode wifi network information data: %d", err);
            continue;
        }

        status = golioth_net_info_finish(info);
        if (status != GOLIOTH_OK)
        {
            if (status == GOLIOTH_ERR_NULL)
            {
                LOG_WRN("No network information data provided");
                return 0;
            }

            LOG_ERR("Failed to encode network information data");
            return -ENOMEM;
        }

        /* Always use blockwise upload to ensure large payloads are delivered successfully */
        struct block_upload_source bu_source = {.buf = golioth_net_info_get_buf(info),
                                                .len = golioth_net_info_get_buf_len(info)};

        int err = golioth_stream_set_blockwise_sync(client,
                                                    "data/loc/net",
                                                    GOLIOTH_CONTENT_TYPE_CBOR,
                                                    block_upload_read_chunk,
                                                    (void *) &bu_source);
        if (err != GOLIOTH_OK)
        {
            LOG_ERR("Failed to stream network data: %d (%s)", err, golioth_status_to_str(err));
        }
        else
        {
            LOG_INF("Successfully streamed network data");
        }

        k_msleep(CONFIG_APP_LOCATION_GET_INTERVAL);
    }

    return 0;
}
```

## src/cellular.h
```c
/*
 * Copyright (c) 2025 Golioth, Inc.
 *
 * SPDX-License-Identifier: Apache-2.0
 */

#pragma once

#include <golioth/net_info/cellular.h>

int cellular_info_get(struct golioth_cellular_info *infos,
                      size_t num_max_infos,
                      size_t *num_returned_infos);
```

## src/cellular_nrf91.c
```c
/*
 * Copyright (c) 2025 Golioth, Inc.
 *
 * SPDX-License-Identifier: Apache-2.0
 */

#include <zephyr/logging/log.h>
LOG_MODULE_REGISTER(cellular_nrf91);

#include <modem/lte_lc.h>

#include "cellular.h"

/* Indicates when individual ncellmeas operation is completed. This is internal to this file. */
static K_SEM_DEFINE(scan_cellular_sem_ncellmeas_evt, 0, 1);

static enum lte_lc_lte_mode lte_mode;
static struct lte_lc_ncell neighbor_cells[CONFIG_LTE_NEIGHBOR_CELLS_MAX];
static struct lte_lc_cells_info scan_cellular_info = {
    .neighbor_cells = neighbor_cells,
};

static const char *lte_mode_to_str(enum lte_lc_lte_mode mode)
{
    switch (mode)
    {
        case LTE_LC_LTE_MODE_NONE:
            return "NONE";
        case LTE_LC_LTE_MODE_LTEM:
            return "LTEM";
        case LTE_LC_LTE_MODE_NBIOT:
            return "NBIOT";
        case LTE_LC_LTE_MODE_NTN_NBIOT:
            return "NTN_NBIOT";
    }

    return "unknown";
}

static void lte_ind_handler(const struct lte_lc_evt *const evt)
{
    switch (evt->type)
    {
        case LTE_LC_EVT_LTE_MODE_UPDATE:
            LOG_INF("LTE mode: %s", lte_mode_to_str(evt->lte_mode));
            lte_mode = evt->lte_mode;
            break;
        case LTE_LC_EVT_CELL_UPDATE:
            LOG_INF("LTE cell changed: Cell ID: %d, Tracking area: %d",
                    evt->cell.id,
                    evt->cell.tac);
            break;
        case LTE_LC_EVT_NEIGHBOR_CELL_MEAS:
            LOG_INF("LTE current cell: MCC %d, MNC %d, Cell ID: %d, Tracking area: %d",
                    evt->cells_info.current_cell.mcc,
                    evt->cells_info.current_cell.mnc,
                    evt->cells_info.current_cell.id,
                    evt->cells_info.current_cell.tac);

            LOG_INF(
                "Cell measurements results received: "
                "ncells_count=%d, gci_cells_count=%d, current_cell.id=0x%08X",
                evt->cells_info.ncells_count,
                evt->cells_info.gci_cells_count,
                evt->cells_info.current_cell.id);

            if (evt->cells_info.current_cell.id != LTE_LC_CELL_EUTRAN_ID_INVALID)
            {
                /* Copy current cell information. We are seeing this is not set for GCI
                 * search sometimes but we have it for the previous normal neighbor search.
                 */
                memcpy(&scan_cellular_info.current_cell,
                       &evt->cells_info.current_cell,
                       sizeof(struct lte_lc_cell));
            }

            /* Copy neighbor cell information if present */
            if (evt->cells_info.ncells_count > 0 && evt->cells_info.neighbor_cells)
            {
                memcpy(scan_cellular_info.neighbor_cells,
                       evt->cells_info.neighbor_cells,
                       sizeof(struct lte_lc_ncell) * evt->cells_info.ncells_count);

                scan_cellular_info.ncells_count = evt->cells_info.ncells_count;
            }
            else
            {
                LOG_DBG("No neighbor cell information from modem");
            }

            /* Copy surrounding cell information if present */
            if (evt->cells_info.gci_cells_count > 0 && evt->cells_info.gci_cells)
            {
                memcpy(scan_cellular_info.gci_cells,
                       evt->cells_info.gci_cells,
                       sizeof(struct lte_lc_cell) * evt->cells_info.gci_cells_count);

                scan_cellular_info.gci_cells_count = evt->cells_info.gci_cells_count;
            }
            else
            {
                LOG_DBG("No surrounding cell information from modem");
            }

            k_sem_give(&scan_cellular_sem_ncellmeas_evt);
            break;

        default:
            break;
    }
}

int cellular_info_get(struct golioth_cellular_info *infos,
                      size_t num_max_infos,
                      size_t *num_returned_infos)
{
    struct lte_lc_ncellmeas_params params = {
        .search_type = LTE_LC_NEIGHBOR_SEARCH_TYPE_EXTENDED_LIGHT,
    };
    struct lte_lc_cell *current = &scan_cellular_info.current_cell;
    int err;

    err = lte_lc_neighbor_cell_measurement(&params);
    if (err)
    {
        return err;
    }

    err = k_sem_take(&scan_cellular_sem_ncellmeas_evt, K_FOREVER);
    if (err)
    {
        /* Semaphore was reset so stop search procedure */
        err = 0;
    }

    switch (lte_mode)
    {
        case LTE_LC_LTE_MODE_LTEM:
            infos[0].type = GOLIOTH_CELLULAR_TYPE_LTECATM;
            break;
        case LTE_LC_LTE_MODE_NBIOT:
            infos[0].type = GOLIOTH_CELLULAR_TYPE_NBIOT;
            break;
        default:
            *num_returned_infos = 0;
            return 0;
    }

    infos[0].mcc = current->mcc;
    infos[0].mnc = current->mnc;
    infos[0].id = current->id;

    *num_returned_infos = 1;

    return 0;
}

static int cellular_nrf91_init(void)
{
    lte_lc_register_handler(lte_ind_handler);

    return 0;
}

SYS_INIT(cellular_nrf91_init, APPLICATION, CONFIG_APPLICATION_INIT_PRIORITY);
```

## src/cellular_playback.c
```c
/*
 * Copyright (c) 2025 Golioth, Inc.
 *
 * SPDX-License-Identifier: Apache-2.0
 */

#include <zephyr/logging/log.h>
LOG_MODULE_REGISTER(cellular_playback, LOG_LEVEL_DBG);

#include <zephyr/net/net_offload.h>

#include "cellular.h"

struct cellular_playback_info
{
    int64_t ts;
    const struct golioth_cellular_info *infos;
    size_t num_infos;
};

struct cellular_playback_config
{
    const struct cellular_playback_info *infos;
    size_t num_infos;
};

struct cellular_playback_data
{
    const struct cellular_playback_config *config;
    size_t info_idx;
};

static const struct cellular_playback_config cellular_playback_config_0;
static struct cellular_playback_data cellular_playback_data_0;

int cellular_info_get(struct golioth_cellular_info *infos,
                      size_t num_max_infos,
                      size_t *num_returned_infos)
{
    struct cellular_playback_data *data = &cellular_playback_data_0;
    const struct cellular_playback_config *config = data->config;
    const struct cellular_playback_info *playback_info = &config->infos[data->info_idx];
    size_t num_copied_infos = MIN(playback_info->num_infos, num_max_infos);

    k_sleep(K_TIMEOUT_ABS_MS(playback_info->ts * 1000 / CONFIG_GOLIOTH_PLAYBACK_SPEED_FACTOR));

    memcpy(infos, playback_info->infos, num_copied_infos * sizeof(*infos));
    *num_returned_infos = num_copied_infos;

    data->info_idx++;

    return 0;
}

static int cellular_playback_init(void)
{
    const struct cellular_playback_config *config = &cellular_playback_config_0;
    struct cellular_playback_data *data = &cellular_playback_data_0;

    data->config = config;

    return 0;
}

#include "cellular_playback_input.c"

static const struct cellular_playback_config cellular_playback_config_0 = {
    .infos = cellular_infos,
    .num_infos = ARRAY_SIZE(cellular_infos),
};

SYS_INIT(cellular_playback_init, APPLICATION, CONFIG_APPLICATION_INIT_PRIORITY);
```

## src/cellular_playback_input.c
```c
/*
 * Copyright (c) 2025 Golioth, Inc.
 *
 * SPDX-License-Identifier: Apache-2.0
 */

static const struct golioth_cellular_info cellular_infos_15000[] = {
    {.type = GOLIOTH_CELLULAR_TYPE_LTECATM, .mcc = 260, .mnc = 3, .id = 35115045, .strength = -113},
    {.type = GOLIOTH_CELLULAR_TYPE_LTECATM, .mcc = 260, .mnc = 3, .id = 35115045, .strength = -95},
};
static const struct golioth_cellular_info cellular_infos_20000[] = {
    {.type = GOLIOTH_CELLULAR_TYPE_LTECATM, .mcc = 260, .mnc = 3, .id = 35115046, .strength = -90},
};
static const struct golioth_cellular_info cellular_infos_25000[] = {
    {.type = GOLIOTH_CELLULAR_TYPE_LTECATM, .mcc = 260, .mnc = 3, .id = 35115045, .strength = -113},
    {.type = GOLIOTH_CELLULAR_TYPE_LTECATM, .mcc = 260, .mnc = 3, .id = 35115046, .strength = -75},
};
static const struct golioth_cellular_info cellular_infos_35000[] = {
    {.type = GOLIOTH_CELLULAR_TYPE_LTECATM, .mcc = 260, .mnc = 3, .id = 35115045, .strength = -113},
    {.type = GOLIOTH_CELLULAR_TYPE_LTECATM, .mcc = 260, .mnc = 3, .id = 35115046, .strength = -89},
};
static const struct golioth_cellular_info cellular_infos_40000[] = {
    {.type = GOLIOTH_CELLULAR_TYPE_LTECATM, .mcc = 260, .mnc = 3, .id = 60725279, .strength = -98},
};
static const struct golioth_cellular_info cellular_infos_70000[] = {
    {.type = GOLIOTH_CELLULAR_TYPE_LTECATM, .mcc = 260, .mnc = 3, .id = 35115044, .strength = -97},
};
static const struct golioth_cellular_info cellular_infos_75000[] = {
    {.type = GOLIOTH_CELLULAR_TYPE_LTECATM, .mcc = 260, .mnc = 3, .id = 35115045, .strength = -113},
    {.type = GOLIOTH_CELLULAR_TYPE_LTECATM, .mcc = 260, .mnc = 3, .id = 35115044, .strength = -88},
};
static const struct golioth_cellular_info cellular_infos_85000[] = {
    {.type = GOLIOTH_CELLULAR_TYPE_LTECATM, .mcc = 260, .mnc = 3, .id = 35115045, .strength = -113},
    {.type = GOLIOTH_CELLULAR_TYPE_LTECATM, .mcc = 260, .mnc = 3, .id = 35115044, .strength = -99},
};
static const struct golioth_cellular_info cellular_infos_90000[] = {
    {.type = GOLIOTH_CELLULAR_TYPE_LTECATM, .mcc = 260, .mnc = 3, .id = 35115045, .strength = -113},
    {.type = GOLIOTH_CELLULAR_TYPE_LTECATM, .mcc = 260, .mnc = 3, .id = 35115044, .strength = -87},
};
static const struct golioth_cellular_info cellular_infos_96000[] = {
    {.type = GOLIOTH_CELLULAR_TYPE_LTECATM, .mcc = 260, .mnc = 3, .id = 35115045, .strength = -113},
    {.type = GOLIOTH_CELLULAR_TYPE_LTECATM, .mcc = 260, .mnc = 3, .id = 35115044, .strength = -104},
};
static const struct golioth_cellular_info cellular_infos_105000[] = {
    {.type = GOLIOTH_CELLULAR_TYPE_LTECATM, .mcc = 260, .mnc = 3, .id = 35115045, .strength = -113},
    {.type = GOLIOTH_CELLULAR_TYPE_LTECATM, .mcc = 260, .mnc = 3, .id = 35094310, .strength = -100},
};
static const struct golioth_cellular_info cellular_infos_111000[] = {
    {.type = GOLIOTH_CELLULAR_TYPE_LTECATM, .mcc = 260, .mnc = 3, .id = 35115044, .strength = -109},
};
static const struct golioth_cellular_info cellular_infos_136000[] = {
    {.type = GOLIOTH_CELLULAR_TYPE_LTECATM, .mcc = 260, .mnc = 3, .id = 35115045, .strength = -113},
    {.type = GOLIOTH_CELLULAR_TYPE_LTECATM, .mcc = 260, .mnc = 3, .id = 35094310, .strength = -111},
};
static const struct golioth_cellular_info cellular_infos_146000[] = {
    {.type = GOLIOTH_CELLULAR_TYPE_LTECATM, .mcc = 260, .mnc = 3, .id = 35115045, .strength = -113},
    {.type = GOLIOTH_CELLULAR_TYPE_LTECATM, .mcc = 260, .mnc = 3, .id = 35094310, .strength = -107},
};
static const struct golioth_cellular_info cellular_infos_151000[] = {
    {.type = GOLIOTH_CELLULAR_TYPE_LTECATM, .mcc = 260, .mnc = 3, .id = 35094310, .strength = -102},
};
static const struct golioth_cellular_info cellular_infos_156000[] = {
    {.type = GOLIOTH_CELLULAR_TYPE_LTECATM, .mcc = 260, .mnc = 3, .id = 35115045, .strength = -113},
    {.type = GOLIOTH_CELLULAR_TYPE_LTECATM, .mcc = 260, .mnc = 3, .id = 35115044, .strength = -106},
};
static const struct golioth_cellular_info cellular_infos_166000[] = {
    {.type = GOLIOTH_CELLULAR_TYPE_LTECATM, .mcc = 260, .mnc = 3, .id = 35115045, .strength = -113},
    {.type = GOLIOTH_CELLULAR_TYPE_LTECATM, .mcc = 260, .mnc = 3, .id = 35094310, .strength = -113},
};
static const struct golioth_cellular_info cellular_infos_171000[] = {
    {.type = GOLIOTH_CELLULAR_TYPE_LTECATM, .mcc = 260, .mnc = 3, .id = 35094290, .strength = -92},
};
static const struct golioth_cellular_info cellular_infos_176000[] = {
    {.type = GOLIOTH_CELLULAR_TYPE_LTECATM, .mcc = 260, .mnc = 3, .id = 35115045, .strength = -113},
    {.type = GOLIOTH_CELLULAR_TYPE_LTECATM, .mcc = 260, .mnc = 3, .id = 35094298, .strength = -100},
};
static const struct golioth_cellular_info cellular_infos_181000[] = {
    {.type = GOLIOTH_CELLULAR_TYPE_LTECATM, .mcc = 260, .mnc = 3, .id = 35115045, .strength = -113},
    {.type = GOLIOTH_CELLULAR_TYPE_LTECATM, .mcc = 260, .mnc = 3, .id = 35094298, .strength = -96},
};
static const struct golioth_cellular_info cellular_infos_191000[] = {
    {.type = GOLIOTH_CELLULAR_TYPE_LTECATM, .mcc = 260, .mnc = 3, .id = 35115045, .strength = -113},
    {.type = GOLIOTH_CELLULAR_TYPE_LTECATM, .mcc = 260, .mnc = 3, .id = 35094298, .strength = -97},
};
static const struct golioth_cellular_info cellular_infos_196000[] = {
    {.type = GOLIOTH_CELLULAR_TYPE_LTECATM, .mcc = 260, .mnc = 3, .id = 35115547, .strength = -99},
};
static const struct golioth_cellular_info cellular_infos_201000[] = {
    {.type = GOLIOTH_CELLULAR_TYPE_LTECATM, .mcc = 260, .mnc = 3, .id = 35115557, .strength = -95},
};
static const struct golioth_cellular_info cellular_infos_266000[] = {
    {.type = GOLIOTH_CELLULAR_TYPE_LTECATM, .mcc = 260, .mnc = 3, .id = 35115558, .strength = -97},
};
static const struct golioth_cellular_info cellular_infos_292000[] = {
    {.type = GOLIOTH_CELLULAR_TYPE_LTECATM, .mcc = 260, .mnc = 3, .id = 35115558, .strength = -113},
    {.type = GOLIOTH_CELLULAR_TYPE_LTECATM, .mcc = 260, .mnc = 3, .id = 35115557, .strength = -95},
};
static const struct golioth_cellular_info cellular_infos_296000[] = {
    {.type = GOLIOTH_CELLULAR_TYPE_LTECATM, .mcc = 260, .mnc = 3, .id = 35115558, .strength = -90},
};
static const struct golioth_cellular_info cellular_infos_306000[] = {
    {.type = GOLIOTH_CELLULAR_TYPE_LTECATM, .mcc = 260, .mnc = 3, .id = 35115558, .strength = -113},
    {.type = GOLIOTH_CELLULAR_TYPE_LTECATM, .mcc = 260, .mnc = 3, .id = 35115558, .strength = -92},
};
static const struct golioth_cellular_info cellular_infos_322000[] = {
    {.type = GOLIOTH_CELLULAR_TYPE_LTECATM, .mcc = 260, .mnc = 3, .id = 35115558, .strength = -113},
    {.type = GOLIOTH_CELLULAR_TYPE_LTECATM, .mcc = 260, .mnc = 3, .id = 35115558, .strength = -101},
};
static const struct golioth_cellular_info cellular_infos_347000[] = {
    {.type = GOLIOTH_CELLULAR_TYPE_LTECATM, .mcc = 260, .mnc = 3, .id = 35115558, .strength = -95},
};
static const struct golioth_cellular_info cellular_infos_407000[] = {
    {.type = GOLIOTH_CELLULAR_TYPE_LTECATM, .mcc = 260, .mnc = 3, .id = 35115558, .strength = -85},
};

static const struct cellular_playback_info cellular_infos[] = {
    {
        15000,
        cellular_infos_15000,
        ARRAY_SIZE(cellular_infos_15000),
    },
    {
        20000,
        cellular_infos_20000,
        ARRAY_SIZE(cellular_infos_20000),
    },
    {
        25000,
        cellular_infos_25000,
        ARRAY_SIZE(cellular_infos_25000),
    },
    {
        35000,
        cellular_infos_35000,
        ARRAY_SIZE(cellular_infos_35000),
    },
    {
        40000,
        cellular_infos_40000,
        ARRAY_SIZE(cellular_infos_40000),
    },
    {
        70000,
        cellular_infos_70000,
        ARRAY_SIZE(cellular_infos_70000),
    },
    {
        75000,
        cellular_infos_75000,
        ARRAY_SIZE(cellular_infos_75000),
    },
    {
        85000,
        cellular_infos_85000,
        ARRAY_SIZE(cellular_infos_85000),
    },
    {
        90000,
        cellular_infos_90000,
        ARRAY_SIZE(cellular_infos_90000),
    },
    {
        96000,
        cellular_infos_96000,
        ARRAY_SIZE(cellular_infos_96000),
    },
    {
        105000,
        cellular_infos_105000,
        ARRAY_SIZE(cellular_infos_105000),
    },
    {
        111000,
        cellular_infos_111000,
        ARRAY_SIZE(cellular_infos_111000),
    },
    {
        136000,
        cellular_infos_136000,
        ARRAY_SIZE(cellular_infos_136000),
    },
    {
        146000,
        cellular_infos_146000,
        ARRAY_SIZE(cellular_infos_146000),
    },
    {
        151000,
        cellular_infos_151000,
        ARRAY_SIZE(cellular_infos_151000),
    },
    {
        156000,
        cellular_infos_156000,
        ARRAY_SIZE(cellular_infos_156000),
    },
    {
        166000,
        cellular_infos_166000,
        ARRAY_SIZE(cellular_infos_166000),
    },
    {
        171000,
        cellular_infos_171000,
        ARRAY_SIZE(cellular_infos_171000),
    },
    {
        176000,
        cellular_infos_176000,
        ARRAY_SIZE(cellular_infos_176000),
    },
    {
        181000,
        cellular_infos_181000,
        ARRAY_SIZE(cellular_infos_181000),
    },
    {
        191000,
        cellular_infos_191000,
        ARRAY_SIZE(cellular_infos_191000),
    },
    {
        196000,
        cellular_infos_196000,
        ARRAY_SIZE(cellular_infos_196000),
    },
    {
        201000,
        cellular_infos_201000,
        ARRAY_SIZE(cellular_infos_201000),
    },
    {
        266000,
        cellular_infos_266000,
        ARRAY_SIZE(cellular_infos_266000),
    },
    {
        292000,
        cellular_infos_292000,
        ARRAY_SIZE(cellular_infos_292000),
    },
    {
        296000,
        cellular_infos_296000,
        ARRAY_SIZE(cellular_infos_296000),
    },
    {
        306000,
        cellular_infos_306000,
        ARRAY_SIZE(cellular_infos_306000),
    },
    {
        322000,
        cellular_infos_322000,
        ARRAY_SIZE(cellular_infos_322000),
    },
    {
        347000,
        cellular_infos_347000,
        ARRAY_SIZE(cellular_infos_347000),
    },
    {
        407000,
        cellular_infos_407000,
        ARRAY_SIZE(cellular_infos_407000),
    },
};
```

## src/wifi_playback.c
```c
/*
 * Copyright (c) 2024 Golioth, Inc.
 *
 * SPDX-License-Identifier: Apache-2.0
 */

#include <zephyr/logging/log.h>
LOG_MODULE_REGISTER(wifi_playback, LOG_LEVEL_DBG);

#define DT_DRV_COMPAT golioth_wifi_playback

#include <zephyr/net/net_offload.h>
#include <zephyr/net/wifi_mgmt.h>

struct wifi_playback_scan_result
{
    uint8_t mac[WIFI_MAC_ADDR_LEN];
    int rssi;
};

struct wifi_playback_scan
{
    int64_t ts;
    const struct wifi_playback_scan_result *results;
    size_t num_results;
};

struct wifi_playback_config
{
    struct net_if *net_iface;
    const struct wifi_playback_scan *scans;
    size_t num_scans;
};

struct wifi_playback_data
{
    const struct wifi_playback_config *config;
    scan_result_cb_t scan_cb;
    struct k_work_delayable scan_work;
    size_t scan_idx;
};

#define SCAN_WORK_QUEUE_STACK_SIZE 2048

K_THREAD_STACK_DEFINE(scan_work_queue_stack_area, SCAN_WORK_QUEUE_STACK_SIZE);

static struct k_work_q scan_work_queue;

static void wifi_playback_scan_handle(struct k_work *work)
{
    struct k_work_delayable *dwork = k_work_delayable_from_work(work);
    struct wifi_playback_data *data = CONTAINER_OF(dwork, struct wifi_playback_data, scan_work);
    const struct wifi_playback_config *config = data->config;
    const struct wifi_playback_scan *scan = &config->scans[data->scan_idx];

    for (size_t i = 0; i < scan->num_results; i++)
    {
        struct wifi_scan_result scan_result = {};

        memcpy(scan_result.mac, scan->results[i].mac, WIFI_MAC_ADDR_LEN);
        scan_result.mac_length = WIFI_MAC_ADDR_LEN;

        scan_result.rssi = scan->results[i].rssi;

        data->scan_cb(config->net_iface, 0, &scan_result);
    }

    data->scan_cb(config->net_iface, 0, NULL);
    data->scan_cb = NULL;

    data->scan_idx++;
}

static int wifi_playback_mgmt_scan(const struct device *dev,
                                   struct wifi_scan_params *params,
                                   scan_result_cb_t cb)
{
    const struct wifi_playback_config *config = dev->config;
    struct net_if *net_iface = config->net_iface;
    struct wifi_playback_data *data = dev->data;
    const struct wifi_playback_scan *scan = &config->scans[data->scan_idx];

    ARG_UNUSED(params);

    if (!net_if_is_carrier_ok(net_iface))
    {
        return -EIO;
    }

    data->scan_cb = cb;

    if (scan->ts == SYS_FOREVER_MS)
    {
        LOG_INF("No more WiFi scans");
        return 0;
    }

    k_work_schedule_for_queue(
        &scan_work_queue,
        &data->scan_work,
        K_TIMEOUT_ABS_MS(scan->ts * 1000 / CONFIG_GOLIOTH_PLAYBACK_SPEED_FACTOR));

    return 0;
}

static int wifi_playback_mgmt_iface_status(const struct device *dev,
                                           struct wifi_iface_status *status)
{
    const struct wifi_playback_config *config = dev->config;
    struct net_if *net_iface = config->net_iface;

    memset(status, 0x0, sizeof(*status));

    status->state = WIFI_STATE_INACTIVE;
    status->band = WIFI_FREQ_BAND_UNKNOWN;
    status->iface_mode = WIFI_MODE_UNKNOWN;
    status->link_mode = WIFI_LINK_MODE_UNKNOWN;
    status->security = WIFI_SECURITY_TYPE_UNKNOWN;
    status->mfp = WIFI_MFP_UNKNOWN;

    if (!net_if_is_carrier_ok(net_iface))
    {
        status->state = WIFI_STATE_INTERFACE_DISABLED;
        return 0;
    }

    return 0;
}

static const struct wifi_mgmt_ops wifi_playback_mgmt_ops = {
    .scan = wifi_playback_mgmt_scan,
    .iface_status = wifi_playback_mgmt_iface_status,
};

static struct net_offload wifi_playback_net_offload;

static void wifi_playback_iface_init(struct net_if *iface)
{
    iface->if_dev->offload = &wifi_playback_net_offload;

    net_if_flag_set(iface, NET_IF_NO_AUTO_START);

    /* Not currently connected to a network */
    net_if_dormant_on(iface);

    /* Admin up, so that scan requests succeed */
    net_if_up(iface);
}

static enum offloaded_net_if_types wifi_playback_offload_get_type(void)
{
    return L2_OFFLOADED_NET_IF_TYPE_WIFI;
}

static const struct net_wifi_mgmt_offload wifi_playback_api = {
    .wifi_iface.iface_api.init = wifi_playback_iface_init,
    .wifi_iface.get_type = wifi_playback_offload_get_type,
    .wifi_mgmt_api = &wifi_playback_mgmt_ops,
};

static int wifi_playback_init(const struct device *dev)
{
    const struct wifi_playback_config *config = dev->config;
    struct wifi_playback_data *data = dev->data;

    data->config = config;
    k_work_init_delayable(&data->scan_work, wifi_playback_scan_handle);

    k_work_queue_init(&scan_work_queue);
    k_work_queue_start(&scan_work_queue,
                       scan_work_queue_stack_area,
                       K_THREAD_STACK_SIZEOF(scan_work_queue_stack_area),
                       K_HIGHEST_THREAD_PRIO,
                       NULL);

    return 0;
}

static const struct wifi_playback_config wifi_playback_config_0;

static struct wifi_playback_data wifi_playback_data_0;

NET_DEVICE_DT_INST_OFFLOAD_DEFINE(0,
                                  wifi_playback_init,
                                  NULL,
                                  &wifi_playback_data_0,
                                  &wifi_playback_config_0,
                                  CONFIG_WIFI_INIT_PRIORITY,
                                  &wifi_playback_api,
                                  NET_ETH_MTU);

#include "wifi_playback_input.c"

static const struct wifi_playback_config wifi_playback_config_0 = {
    .net_iface = NET_IF_GET(Z_DEVICE_DT_DEV_ID(DT_DRV_INST(0)), 0),
    .scans = scan_results,
    .num_scans = ARRAY_SIZE(scan_results),
};
```
