## CMakeLists.txt
```
# SPDX-License-Identifier: Apache-2.0

cmake_minimum_required(VERSION 3.20.0)

find_package(Zephyr REQUIRED HINTS $ENV{ZEPHYR_BASE})
project(location_cellular)

target_sources(app PRIVATE src/main.c)
target_sources_ifdef(CONFIG_GOLIOTH_CELLULAR_PLAYBACK app PRIVATE src/cellular_playback.c)
target_sources_ifdef(CONFIG_SOC_SERIES_NRF91X app PRIVATE src/cellular_nrf91.c)
```

## Kconfig
```
# Copyright (c) 2021-2024 Golioth, Inc.
# SPDX-License-Identifier: Apache-2.0

source "${ZEPHYR_GOLIOTH_FIRMWARE_SDK_MODULE_DIR}/examples/zephyr/common/Kconfig.defconfig"

config APP_LOCATION_GET_INTERVAL
    int "Interval (msec)"
    default 0 if GOLIOTH_CELLULAR_PLAYBACK
    default 5000
    help
      Interval (msec) between requests of location information using cellular data.

config GOLIOTH_CELLULAR_PLAYBACK
    bool
    default y
    depends on DT_HAS_GOLIOTH_CELLULAR_PLAYBACK_ENABLED

if GOLIOTH_CELLULAR_PLAYBACK

config GOLIOTH_CELLULAR_PLAYBACK_SPEED_FACTOR
    int "Speed factor"
    default 1000
    help
      Speed of playback.

      1000 means 1x (normal) speed.
      3000 means 3x speed.
      500 means 0.5x speed.

endif # GOLIOTH_CELLULAR_PLAYBACK

source "Kconfig.zephyr"
```

## sample.yaml
```
sample:
  description: Location Cellular
  name: location cellular
common:
  build_only: true
  tags:
    - golioth
    - location
    - socket
tests:
  sample.golioth.location_cellular:
    platform_allow:
      - native_sim
      - native_sim/native/64
      - nrf9151dk/nrf9151/ns
      - nrf9160dk/nrf9160/ns
```

## prj.conf
```kconfig
# Application
CONFIG_GOLIOTH_SAMPLE_COMMON=y
CONFIG_GOLIOTH_SAMPLE_HARDCODED_CREDENTIALS=y

# Golioth Firmware SDK with all dependencies
CONFIG_GOLIOTH_FIRMWARE_SDK=y

CONFIG_GOLIOTH_LOCATION=y
CONFIG_GOLIOTH_LOCATION_CELLULAR=y
```

## socs/nrf9151_ns.conf
```kconfig
# General config
CONFIG_HEAP_MEM_POOL_SIZE=4096
CONFIG_NEWLIB_LIBC=y

# Networking
CONFIG_NET_SOCKETS_OFFLOAD=y
CONFIG_NET_IPV6=y
CONFIG_NET_IPV6_NBR_CACHE=n
CONFIG_NET_IPV6_MLD=n

# Increase native TLS socket implementation, so that it is chosen instead of
# offloaded nRF91 sockets
CONFIG_NET_SOCKETS_TLS_PRIORITY=35

# Modem library
CONFIG_NRF_MODEM_LIB=y

# LTE connectivity with network connection manager
CONFIG_NRF_MODEM_LIB_NET_IF=y
CONFIG_NRF_MODEM_LIB_NET_IF_AUTO_START=y
CONFIG_NRF_MODEM_LIB_NET_IF_AUTO_CONNECT=y
CONFIG_NET_CONNECTION_MANAGER=y
CONFIG_NET_CONNECTION_MANAGER_MONITOR_STACK_SIZE=1024

# Increased sysworkq size, due to LTE connectivity
CONFIG_SYSTEM_WORKQUEUE_STACK_SIZE=2048

# Disable options y-selected by NCS for no good reason
CONFIG_MBEDTLS_KEY_EXCHANGE_DHE_PSK_ENABLED=n
CONFIG_MBEDTLS_KEY_EXCHANGE_DHE_RSA_ENABLED=n

# MbedTLS configuration to support p-384 curve. These options
# enable using the MbedTLS built-in support for operations not
# supported by the default nRF Oberon crypto backend
CONFIG_NORDIC_SECURITY_BACKEND=n
CONFIG_MBEDTLS_LEGACY_CRYPTO_C=y

# Generate MCUboot compatible images
CONFIG_BOOTLOADER_MCUBOOT=y

CONFIG_LTE_LC_NEIGHBOR_CELL_MEAS_MODULE=y
```

## socs/nrf9160_ns.conf
```kconfig
# General config
CONFIG_HEAP_MEM_POOL_SIZE=4096
CONFIG_NEWLIB_LIBC=y

# Networking
CONFIG_NET_SOCKETS_OFFLOAD=y
CONFIG_NET_IPV6=y
CONFIG_NET_IPV6_NBR_CACHE=n
CONFIG_NET_IPV6_MLD=n

# Increase native TLS socket implementation, so that it is chosen instead of
# offloaded nRF91 sockets
CONFIG_NET_SOCKETS_TLS_PRIORITY=35

# Modem library
CONFIG_NRF_MODEM_LIB=y

# LTE connectivity with network connection manager
CONFIG_NRF_MODEM_LIB_NET_IF=y
CONFIG_NRF_MODEM_LIB_NET_IF_AUTO_START=y
CONFIG_NRF_MODEM_LIB_NET_IF_AUTO_CONNECT=y
CONFIG_NET_CONNECTION_MANAGER=y
CONFIG_NET_CONNECTION_MANAGER_MONITOR_STACK_SIZE=1024

# Increased sysworkq size, due to LTE connectivity
CONFIG_SYSTEM_WORKQUEUE_STACK_SIZE=2048

# Disable options y-selected by NCS for no good reason
CONFIG_MBEDTLS_KEY_EXCHANGE_DHE_PSK_ENABLED=n
CONFIG_MBEDTLS_KEY_EXCHANGE_DHE_RSA_ENABLED=n

# MbedTLS configuration to support p-384 curve. These options
# enable using the MbedTLS built-in support for operations not
# supported by the default nRF Oberon crypto backend
CONFIG_NORDIC_SECURITY_BACKEND=n
CONFIG_MBEDTLS_LEGACY_CRYPTO_C=y

CONFIG_LTE_LC_NEIGHBOR_CELL_MEAS_MODULE=y
```

## socs/native.overlay
```dts
/ {
	cellular-playback {
		compatible = "golioth,cellular-playback";
		status = "okay";
	};
};
```

## dts/bindings/modem/golioth,cellular-playback.yaml
```yaml
# Copyright (c) 2024 Golioth, Inc.
# SPDX-License-Identifier: Apache-2.0

description: Cellular driver with playback of scanned cellular networks

compatible: "golioth,cellular-playback"

include: base.yaml
```

## src/main.c
```c
/*
 * Copyright (c) 2024 Golioth, Inc.
 *
 * SPDX-License-Identifier: Apache-2.0
 */

#include <zephyr/logging/log.h>
LOG_MODULE_REGISTER(location_cellular_main, LOG_LEVEL_DBG);

#include <golioth/client.h>
#include <golioth/location/cellular.h>
#include <samples/common/sample_credentials.h>
#include <string.h>

#include <samples/common/net_connect.h>

#include "cellular.h"

#define APP_TIMEOUT_S 5

struct golioth_client *client;
static K_SEM_DEFINE(connected, 0, 1);

static void on_client_event(struct golioth_client *client,
                            enum golioth_client_event event,
                            void *arg)
{
    bool is_connected = (event == GOLIOTH_CLIENT_EVENT_CONNECTED);
    if (is_connected)
    {
        k_sem_give(&connected);
    }
    LOG_INF("Golioth client %s", is_connected ? "connected" : "disconnected");
}

static struct golioth_location_req location_req;

static int cellular_get_location(void)
{
    struct golioth_location_rsp location_rsp;
    struct golioth_cellular_info cellular_infos[4];
    enum golioth_status status;
    size_t num_infos;
    int err;

    golioth_location_init(&location_req);

    err = cellular_info_get(cellular_infos, ARRAY_SIZE(cellular_infos), &num_infos);
    if (err)
    {
        LOG_ERR("Failed to get cellular network info: %d", err);
        return err;
    }

    for (size_t i = 0; i < num_infos; i++)
    {
        status = golioth_location_cellular_append(&location_req, &cellular_infos[i]);
        if (status != GOLIOTH_OK)
        {
            LOG_ERR("Failed to append cellular info: %d", status);
            return -ENOMEM;
        }
    }

    status = golioth_location_finish(&location_req);
    if (status != GOLIOTH_OK)
    {
        if (status == GOLIOTH_ERR_NULL)
        {
            LOG_WRN("No location data to be provided");
            return 0;
        }

        LOG_ERR("Failed to encode location data");
        return -ENOMEM;
    }

    status = golioth_location_get_sync(client, &location_req, &location_rsp, APP_TIMEOUT_S);
    if (status == GOLIOTH_OK)
    {
        LOG_INF("%s%lld.%09lld %s%lld.%09lld (%lld)",
                location_rsp.latitude < 0 ? "-" : "",
                llabs(location_rsp.latitude) / 1000000000,
                llabs(location_rsp.latitude) % 1000000000,
                location_rsp.longitude < 0 ? "-" : "",
                llabs(location_rsp.longitude) / 1000000000,
                llabs(location_rsp.longitude) % 1000000000,
                (long long int) location_rsp.accuracy);
    }

    return 0;
}

int main(void)
{
    LOG_DBG("Start cellular location sample");

    net_connect();

    /* Note: In production, you would provision unique credentials onto each
     * device. For simplicity, we provide a utility to hardcode credentials as
     * kconfig options in the samples.
     */
    const struct golioth_client_config *client_config = golioth_sample_credentials_get();

    client = golioth_client_create(client_config);
    golioth_client_register_event_callback(client, on_client_event, NULL);

    k_sem_take(&connected, K_FOREVER);

    while (true)
    {
        cellular_get_location();

        k_msleep(CONFIG_APP_LOCATION_GET_INTERVAL);
    }

    return 0;
}
```

## src/cellular.h
```c
/*
 * Copyright (c) 2024 Golioth, Inc.
 *
 * SPDX-License-Identifier: Apache-2.0
 */

#ifndef __CELLULAR_H__
#define __CELLULAR_H__

#include <golioth/location/cellular.h>

int cellular_info_get(struct golioth_cellular_info *infos,
                      size_t num_max_infos,
                      size_t *num_returned_infos);

#endif /* __CELLULAR_H__ */
```

## src/cellular_nrf91.c
```c
/*
 * Copyright (c) 2024 Golioth, Inc.
 *
 * SPDX-License-Identifier: Apache-2.0
 */

#include <zephyr/logging/log.h>
LOG_MODULE_REGISTER(cellular_nrf91);

#include <modem/lte_lc.h>

#include "cellular.h"

/* Indicates when individual ncellmeas operation is completed. This is internal to this file. */
static K_SEM_DEFINE(scan_cellular_sem_ncellmeas_evt, 0, 1);

static enum lte_lc_lte_mode lte_mode;
static struct lte_lc_ncell neighbor_cells[CONFIG_LTE_NEIGHBOR_CELLS_MAX];
static struct lte_lc_cells_info scan_cellular_info = {
    .neighbor_cells = neighbor_cells,
};

static const char *lte_mode_to_str(enum lte_lc_lte_mode mode)
{
    switch (mode)
    {
        case LTE_LC_LTE_MODE_LTEM:
            return "LTEM";
        case LTE_LC_LTE_MODE_NBIOT:
            return "NBIOT";
        case LTE_LC_LTE_MODE_NONE:
            return "NONE";
    }

    return "unknown";
}

static void lte_ind_handler(const struct lte_lc_evt *const evt)
{
    switch (evt->type)
    {
        case LTE_LC_EVT_LTE_MODE_UPDATE:
            LOG_INF("LTE mode: %s", lte_mode_to_str(evt->lte_mode));
            lte_mode = evt->lte_mode;
            break;
        case LTE_LC_EVT_CELL_UPDATE:
            LOG_INF("LTE cell changed: Cell ID: %d, Tracking area: %d",
                    evt->cell.id,
                    evt->cell.tac);
            break;
        case LTE_LC_EVT_NEIGHBOR_CELL_MEAS:
            LOG_INF("LTE current cell: MCC %d, MNC %d, Cell ID: %d, Tracking area: %d",
                    evt->cells_info.current_cell.mcc,
                    evt->cells_info.current_cell.mnc,
                    evt->cells_info.current_cell.id,
                    evt->cells_info.current_cell.tac);

            LOG_INF(
                "Cell measurements results received: "
                "ncells_count=%d, gci_cells_count=%d, current_cell.id=0x%08X",
                evt->cells_info.ncells_count,
                evt->cells_info.gci_cells_count,
                evt->cells_info.current_cell.id);

            if (evt->cells_info.current_cell.id != LTE_LC_CELL_EUTRAN_ID_INVALID)
            {
                /* Copy current cell information. We are seeing this is not set for GCI
                 * search sometimes but we have it for the previous normal neighbor search.
                 */
                memcpy(&scan_cellular_info.current_cell,
                       &evt->cells_info.current_cell,
                       sizeof(struct lte_lc_cell));
            }

            /* Copy neighbor cell information if present */
            if (evt->cells_info.ncells_count > 0 && evt->cells_info.neighbor_cells)
            {
                memcpy(scan_cellular_info.neighbor_cells,
                       evt->cells_info.neighbor_cells,
                       sizeof(struct lte_lc_ncell) * evt->cells_info.ncells_count);

                scan_cellular_info.ncells_count = evt->cells_info.ncells_count;
            }
            else
            {
                LOG_DBG("No neighbor cell information from modem");
            }

            /* Copy surrounding cell information if present */
            if (evt->cells_info.gci_cells_count > 0 && evt->cells_info.gci_cells)
            {
                memcpy(scan_cellular_info.gci_cells,
                       evt->cells_info.gci_cells,
                       sizeof(struct lte_lc_cell) * evt->cells_info.gci_cells_count);

                scan_cellular_info.gci_cells_count = evt->cells_info.gci_cells_count;
            }
            else
            {
                LOG_DBG("No surrounding cell information from modem");
            }

            k_sem_give(&scan_cellular_sem_ncellmeas_evt);
            break;

        default:
            break;
    }
}

int cellular_info_get(struct golioth_cellular_info *infos,
                      size_t num_max_infos,
                      size_t *num_returned_infos)
{
    struct lte_lc_ncellmeas_params params = {
        .search_type = LTE_LC_NEIGHBOR_SEARCH_TYPE_EXTENDED_LIGHT,
    };
    struct lte_lc_cell *current = &scan_cellular_info.current_cell;
    int err;

    err = lte_lc_neighbor_cell_measurement(&params);
    if (err)
    {
        return err;
    }

    err = k_sem_take(&scan_cellular_sem_ncellmeas_evt, K_FOREVER);
    if (err)
    {
        /* Semaphore was reset so stop search procedure */
        err = 0;
    }

    switch (lte_mode)
    {
        case LTE_LC_LTE_MODE_LTEM:
            infos[0].type = GOLIOTH_CELLULAR_TYPE_LTECATM;
            break;
        case LTE_LC_LTE_MODE_NBIOT:
            infos[0].type = GOLIOTH_CELLULAR_TYPE_NBIOT;
            break;
        default:
            *num_returned_infos = 0;
            return 0;
    }

    infos[0].mcc = current->mcc;
    infos[0].mnc = current->mnc;
    infos[0].id = current->id;

    *num_returned_infos = 1;

    return 0;
}

static int cellular_nrf91_init(void)
{
    lte_lc_register_handler(lte_ind_handler);

    return 0;
}

SYS_INIT(cellular_nrf91_init, APPLICATION, CONFIG_APPLICATION_INIT_PRIORITY);
```

## src/cellular_playback.c
```c
/*
 * Copyright (c) 2024 Golioth, Inc.
 *
 * SPDX-License-Identifier: Apache-2.0
 */

#include <zephyr/logging/log.h>
LOG_MODULE_REGISTER(cellular_playback, LOG_LEVEL_DBG);

#include <zephyr/net/net_offload.h>

#include "cellular.h"

struct cellular_playback_info
{
    int64_t ts;
    const struct golioth_cellular_info *infos;
    size_t num_infos;
};

struct cellular_playback_config
{
    const struct cellular_playback_info *infos;
    size_t num_infos;
};

struct cellular_playback_data
{
    const struct cellular_playback_config *config;
    size_t info_idx;
};

static const struct cellular_playback_config cellular_playback_config_0;
static struct cellular_playback_data cellular_playback_data_0;

int cellular_info_get(struct golioth_cellular_info *infos,
                      size_t num_max_infos,
                      size_t *num_returned_infos)
{
    struct cellular_playback_data *data = &cellular_playback_data_0;
    const struct cellular_playback_config *config = data->config;
    const struct cellular_playback_info *playback_info = &config->infos[data->info_idx];
    size_t num_copied_infos = MIN(playback_info->num_infos, num_max_infos);

    k_sleep(
        K_TIMEOUT_ABS_MS(playback_info->ts * 1000 / CONFIG_GOLIOTH_CELLULAR_PLAYBACK_SPEED_FACTOR));

    memcpy(infos, playback_info->infos, num_copied_infos * sizeof(*infos));
    *num_returned_infos = num_copied_infos;

    data->info_idx++;

    return 0;
}

static int cellular_playback_init(void)
{
    const struct cellular_playback_config *config = &cellular_playback_config_0;
    struct cellular_playback_data *data = &cellular_playback_data_0;

    data->config = config;

    return 0;
}

#include "cellular_playback_input.c"

static const struct cellular_playback_config cellular_playback_config_0 = {
    .infos = cellular_infos,
    .num_infos = ARRAY_SIZE(cellular_infos),
};

SYS_INIT(cellular_playback_init, APPLICATION, CONFIG_APPLICATION_INIT_PRIORITY);
```

## src/cellular_playback_input.c
```c
/*
 * Copyright (c) 2024 Golioth, Inc.
 *
 * SPDX-License-Identifier: Apache-2.0
 */

static const struct golioth_cellular_info cellular_infos_15000[] = {
    {.type = GOLIOTH_CELLULAR_TYPE_LTECATM, .mcc = 260, .mnc = 3, .id = 35115045, .strength = -113},
    {.type = GOLIOTH_CELLULAR_TYPE_LTECATM, .mcc = 260, .mnc = 3, .id = 35115045, .strength = -95},
};
static const struct golioth_cellular_info cellular_infos_20000[] = {
    {.type = GOLIOTH_CELLULAR_TYPE_LTECATM, .mcc = 260, .mnc = 3, .id = 35115046, .strength = -90},
};
static const struct golioth_cellular_info cellular_infos_25000[] = {
    {.type = GOLIOTH_CELLULAR_TYPE_LTECATM, .mcc = 260, .mnc = 3, .id = 35115045, .strength = -113},
    {.type = GOLIOTH_CELLULAR_TYPE_LTECATM, .mcc = 260, .mnc = 3, .id = 35115046, .strength = -75},
};
static const struct golioth_cellular_info cellular_infos_35000[] = {
    {.type = GOLIOTH_CELLULAR_TYPE_LTECATM, .mcc = 260, .mnc = 3, .id = 35115045, .strength = -113},
    {.type = GOLIOTH_CELLULAR_TYPE_LTECATM, .mcc = 260, .mnc = 3, .id = 35115046, .strength = -89},
};
static const struct golioth_cellular_info cellular_infos_40000[] = {
    {.type = GOLIOTH_CELLULAR_TYPE_LTECATM, .mcc = 260, .mnc = 3, .id = 60725279, .strength = -98},
};
static const struct golioth_cellular_info cellular_infos_70000[] = {
    {.type = GOLIOTH_CELLULAR_TYPE_LTECATM, .mcc = 260, .mnc = 3, .id = 35115044, .strength = -97},
};
static const struct golioth_cellular_info cellular_infos_75000[] = {
    {.type = GOLIOTH_CELLULAR_TYPE_LTECATM, .mcc = 260, .mnc = 3, .id = 35115045, .strength = -113},
    {.type = GOLIOTH_CELLULAR_TYPE_LTECATM, .mcc = 260, .mnc = 3, .id = 35115044, .strength = -88},
};
static const struct golioth_cellular_info cellular_infos_85000[] = {
    {.type = GOLIOTH_CELLULAR_TYPE_LTECATM, .mcc = 260, .mnc = 3, .id = 35115045, .strength = -113},
    {.type = GOLIOTH_CELLULAR_TYPE_LTECATM, .mcc = 260, .mnc = 3, .id = 35115044, .strength = -99},
};
static const struct golioth_cellular_info cellular_infos_90000[] = {
    {.type = GOLIOTH_CELLULAR_TYPE_LTECATM, .mcc = 260, .mnc = 3, .id = 35115045, .strength = -113},
    {.type = GOLIOTH_CELLULAR_TYPE_LTECATM, .mcc = 260, .mnc = 3, .id = 35115044, .strength = -87},
};
static const struct golioth_cellular_info cellular_infos_96000[] = {
    {.type = GOLIOTH_CELLULAR_TYPE_LTECATM, .mcc = 260, .mnc = 3, .id = 35115045, .strength = -113},
    {.type = GOLIOTH_CELLULAR_TYPE_LTECATM, .mcc = 260, .mnc = 3, .id = 35115044, .strength = -104},
};
static const struct golioth_cellular_info cellular_infos_105000[] = {
    {.type = GOLIOTH_CELLULAR_TYPE_LTECATM, .mcc = 260, .mnc = 3, .id = 35115045, .strength = -113},
    {.type = GOLIOTH_CELLULAR_TYPE_LTECATM, .mcc = 260, .mnc = 3, .id = 35094310, .strength = -100},
};
static const struct golioth_cellular_info cellular_infos_111000[] = {
    {.type = GOLIOTH_CELLULAR_TYPE_LTECATM, .mcc = 260, .mnc = 3, .id = 35115044, .strength = -109},
};
static const struct golioth_cellular_info cellular_infos_136000[] = {
    {.type = GOLIOTH_CELLULAR_TYPE_LTECATM, .mcc = 260, .mnc = 3, .id = 35115045, .strength = -113},
    {.type = GOLIOTH_CELLULAR_TYPE_LTECATM, .mcc = 260, .mnc = 3, .id = 35094310, .strength = -111},
};
static const struct golioth_cellular_info cellular_infos_146000[] = {
    {.type = GOLIOTH_CELLULAR_TYPE_LTECATM, .mcc = 260, .mnc = 3, .id = 35115045, .strength = -113},
    {.type = GOLIOTH_CELLULAR_TYPE_LTECATM, .mcc = 260, .mnc = 3, .id = 35094310, .strength = -107},
};
static const struct golioth_cellular_info cellular_infos_151000[] = {
    {.type = GOLIOTH_CELLULAR_TYPE_LTECATM, .mcc = 260, .mnc = 3, .id = 35094310, .strength = -102},
};
static const struct golioth_cellular_info cellular_infos_156000[] = {
    {.type = GOLIOTH_CELLULAR_TYPE_LTECATM, .mcc = 260, .mnc = 3, .id = 35115045, .strength = -113},
    {.type = GOLIOTH_CELLULAR_TYPE_LTECATM, .mcc = 260, .mnc = 3, .id = 35115044, .strength = -106},
};
static const struct golioth_cellular_info cellular_infos_166000[] = {
    {.type = GOLIOTH_CELLULAR_TYPE_LTECATM, .mcc = 260, .mnc = 3, .id = 35115045, .strength = -113},
    {.type = GOLIOTH_CELLULAR_TYPE_LTECATM, .mcc = 260, .mnc = 3, .id = 35094310, .strength = -113},
};
static const struct golioth_cellular_info cellular_infos_171000[] = {
    {.type = GOLIOTH_CELLULAR_TYPE_LTECATM, .mcc = 260, .mnc = 3, .id = 35094290, .strength = -92},
};
static const struct golioth_cellular_info cellular_infos_176000[] = {
    {.type = GOLIOTH_CELLULAR_TYPE_LTECATM, .mcc = 260, .mnc = 3, .id = 35115045, .strength = -113},
    {.type = GOLIOTH_CELLULAR_TYPE_LTECATM, .mcc = 260, .mnc = 3, .id = 35094298, .strength = -100},
};
static const struct golioth_cellular_info cellular_infos_181000[] = {
    {.type = GOLIOTH_CELLULAR_TYPE_LTECATM, .mcc = 260, .mnc = 3, .id = 35115045, .strength = -113},
    {.type = GOLIOTH_CELLULAR_TYPE_LTECATM, .mcc = 260, .mnc = 3, .id = 35094298, .strength = -96},
};
static const struct golioth_cellular_info cellular_infos_191000[] = {
    {.type = GOLIOTH_CELLULAR_TYPE_LTECATM, .mcc = 260, .mnc = 3, .id = 35115045, .strength = -113},
    {.type = GOLIOTH_CELLULAR_TYPE_LTECATM, .mcc = 260, .mnc = 3, .id = 35094298, .strength = -97},
};
static const struct golioth_cellular_info cellular_infos_196000[] = {
    {.type = GOLIOTH_CELLULAR_TYPE_LTECATM, .mcc = 260, .mnc = 3, .id = 35115547, .strength = -99},
};
static const struct golioth_cellular_info cellular_infos_201000[] = {
    {.type = GOLIOTH_CELLULAR_TYPE_LTECATM, .mcc = 260, .mnc = 3, .id = 35115557, .strength = -95},
};
static const struct golioth_cellular_info cellular_infos_266000[] = {
    {.type = GOLIOTH_CELLULAR_TYPE_LTECATM, .mcc = 260, .mnc = 3, .id = 35115558, .strength = -97},
};
static const struct golioth_cellular_info cellular_infos_292000[] = {
    {.type = GOLIOTH_CELLULAR_TYPE_LTECATM, .mcc = 260, .mnc = 3, .id = 35115558, .strength = -113},
    {.type = GOLIOTH_CELLULAR_TYPE_LTECATM, .mcc = 260, .mnc = 3, .id = 35115557, .strength = -95},
};
static const struct golioth_cellular_info cellular_infos_296000[] = {
    {.type = GOLIOTH_CELLULAR_TYPE_LTECATM, .mcc = 260, .mnc = 3, .id = 35115558, .strength = -90},
};
static const struct golioth_cellular_info cellular_infos_306000[] = {
    {.type = GOLIOTH_CELLULAR_TYPE_LTECATM, .mcc = 260, .mnc = 3, .id = 35115558, .strength = -113},
    {.type = GOLIOTH_CELLULAR_TYPE_LTECATM, .mcc = 260, .mnc = 3, .id = 35115558, .strength = -92},
};
static const struct golioth_cellular_info cellular_infos_322000[] = {
    {.type = GOLIOTH_CELLULAR_TYPE_LTECATM, .mcc = 260, .mnc = 3, .id = 35115558, .strength = -113},
    {.type = GOLIOTH_CELLULAR_TYPE_LTECATM, .mcc = 260, .mnc = 3, .id = 35115558, .strength = -101},
};
static const struct golioth_cellular_info cellular_infos_347000[] = {
    {.type = GOLIOTH_CELLULAR_TYPE_LTECATM, .mcc = 260, .mnc = 3, .id = 35115558, .strength = -95},
};
static const struct golioth_cellular_info cellular_infos_407000[] = {
    {.type = GOLIOTH_CELLULAR_TYPE_LTECATM, .mcc = 260, .mnc = 3, .id = 35115558, .strength = -85},
};

static const struct cellular_playback_info cellular_infos[] = {
    {
        15000,
        cellular_infos_15000,
        ARRAY_SIZE(cellular_infos_15000),
    },
    {
        20000,
        cellular_infos_20000,
        ARRAY_SIZE(cellular_infos_20000),
    },
    {
        25000,
        cellular_infos_25000,
        ARRAY_SIZE(cellular_infos_25000),
    },
    {
        35000,
        cellular_infos_35000,
        ARRAY_SIZE(cellular_infos_35000),
    },
    {
        40000,
        cellular_infos_40000,
        ARRAY_SIZE(cellular_infos_40000),
    },
    {
        70000,
        cellular_infos_70000,
        ARRAY_SIZE(cellular_infos_70000),
    },
    {
        75000,
        cellular_infos_75000,
        ARRAY_SIZE(cellular_infos_75000),
    },
    {
        85000,
        cellular_infos_85000,
        ARRAY_SIZE(cellular_infos_85000),
    },
    {
        90000,
        cellular_infos_90000,
        ARRAY_SIZE(cellular_infos_90000),
    },
    {
        96000,
        cellular_infos_96000,
        ARRAY_SIZE(cellular_infos_96000),
    },
    {
        105000,
        cellular_infos_105000,
        ARRAY_SIZE(cellular_infos_105000),
    },
    {
        111000,
        cellular_infos_111000,
        ARRAY_SIZE(cellular_infos_111000),
    },
    {
        136000,
        cellular_infos_136000,
        ARRAY_SIZE(cellular_infos_136000),
    },
    {
        146000,
        cellular_infos_146000,
        ARRAY_SIZE(cellular_infos_146000),
    },
    {
        151000,
        cellular_infos_151000,
        ARRAY_SIZE(cellular_infos_151000),
    },
    {
        156000,
        cellular_infos_156000,
        ARRAY_SIZE(cellular_infos_156000),
    },
    {
        166000,
        cellular_infos_166000,
        ARRAY_SIZE(cellular_infos_166000),
    },
    {
        171000,
        cellular_infos_171000,
        ARRAY_SIZE(cellular_infos_171000),
    },
    {
        176000,
        cellular_infos_176000,
        ARRAY_SIZE(cellular_infos_176000),
    },
    {
        181000,
        cellular_infos_181000,
        ARRAY_SIZE(cellular_infos_181000),
    },
    {
        191000,
        cellular_infos_191000,
        ARRAY_SIZE(cellular_infos_191000),
    },
    {
        196000,
        cellular_infos_196000,
        ARRAY_SIZE(cellular_infos_196000),
    },
    {
        201000,
        cellular_infos_201000,
        ARRAY_SIZE(cellular_infos_201000),
    },
    {
        266000,
        cellular_infos_266000,
        ARRAY_SIZE(cellular_infos_266000),
    },
    {
        292000,
        cellular_infos_292000,
        ARRAY_SIZE(cellular_infos_292000),
    },
    {
        296000,
        cellular_infos_296000,
        ARRAY_SIZE(cellular_infos_296000),
    },
    {
        306000,
        cellular_infos_306000,
        ARRAY_SIZE(cellular_infos_306000),
    },
    {
        322000,
        cellular_infos_322000,
        ARRAY_SIZE(cellular_infos_322000),
    },
    {
        347000,
        cellular_infos_347000,
        ARRAY_SIZE(cellular_infos_347000),
    },
    {
        407000,
        cellular_infos_407000,
        ARRAY_SIZE(cellular_infos_407000),
    },
};
```
