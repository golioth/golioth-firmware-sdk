## CMakeLists.txt
```
# SPDX-License-Identifier: Apache-2.0

cmake_minimum_required(VERSION 3.20.0)

find_package(Zephyr REQUIRED HINTS $ENV{ZEPHYR_BASE})
project(location_wifi)

target_sources(app PRIVATE src/main.c)
target_sources_ifdef(CONFIG_GOLIOTH_WIFI_PLAYBACK app PRIVATE src/wifi_playback.c)
```

## Kconfig
```
# Copyright (c) 2021-2024 Golioth, Inc.
# SPDX-License-Identifier: Apache-2.0

source "${ZEPHYR_GOLIOTH_FIRMWARE_SDK_MODULE_DIR}/examples/zephyr/common/Kconfig.defconfig"

config GOLIOTH_WIFI_PLAYBACK
    bool
    default y
    depends on DT_HAS_GOLIOTH_WIFI_PLAYBACK_ENABLED

if GOLIOTH_WIFI_PLAYBACK

config GOLIOTH_WIFI_PLAYBACK_SPEED_FACTOR
	int "Speed factor"
    default 1000
    help
      Speed of playback.

      1000 means 1x (normal) speed.
      3000 means 3x speed.
      500 means 0.5x speed.

endif # GOLIOTH_WIFI_PLAYBACK

source "Kconfig.zephyr"
```

## sample.yaml
```
sample:
  description: Location WiFi
  name: location wifi
common:
  tags:
    - golioth
    - location
    - socket
tests:
  sample.golioth.location_wifi:
    build_only: true
    platform_allow:
      - esp32_devkitc_wrover/esp32/procpu
      - nrf52840dk/nrf52840
  sample.golioth.location_wifi.playback:
    harness: pytest
    extra_args: EXTRA_CONF_FILE="../../common/runtime_settings.conf"
    extra_configs:
      - CONFIG_GOLIOTH_SAMPLE_TWISTER_TEST=y
      - arch:posix:CONFIG_NATIVE_UART_0_ON_STDINOUT=y
    platform_allow:
      - native_sim
      - native_sim/native/64
```

## prj.conf
```kconfig
# Application
CONFIG_GOLIOTH_SAMPLE_COMMON=y
CONFIG_GOLIOTH_SAMPLE_HARDCODED_CREDENTIALS=y

# Golioth Firmware SDK with all dependencies
CONFIG_GOLIOTH_FIRMWARE_SDK=y

CONFIG_GOLIOTH_LOCATION=y
CONFIG_GOLIOTH_LOCATION_WIFI=y
CONFIG_WIFI=y
```

## boards/nrf52840dk_nrf52840.conf
```kconfig
CONFIG_WIFI=y
CONFIG_WIFI_ESP_AT=y
CONFIG_WIFI_ESP_AT_MDM_RX_BUF_COUNT=40
CONFIG_WIFI_ESP_AT_CIPDINFO_USE=y
CONFIG_WIFI_ESP_AT_DNS_USE=y
CONFIG_WIFI_ESP_AT_SCAN_MAC_ADDRESS=y
CONFIG_WIFI_ESP_AT_SCAN_RESULT_RSSI_ORDERED=y

CONFIG_NET_L2_WIFI_SHELL=y
CONFIG_GOLIOTH_SAMPLE_WIFI=y
```

## socs/native.conf
```kconfig
# Use offloaded sockets using host BSD sockets
CONFIG_ETH_DRIVER=n
CONFIG_ETH_NATIVE_POSIX=n
CONFIG_NET_DRIVERS=y
CONFIG_NET_SOCKETS=y
CONFIG_NET_SOCKETS_OFFLOAD=y
CONFIG_NET_NATIVE_OFFLOADED_SOCKETS=y
CONFIG_HEAP_MEM_POOL_SIZE=1024

# Use embedded libc to use Zephyr's eventfd instead of host eventfd
CONFIG_PICOLIBC=y

# Static networking
CONFIG_NET_CONFIG_LOG_LEVEL_DBG=y
CONFIG_NET_CONFIG_SETTINGS=y
CONFIG_NET_CONFIG_NEED_IPV4=y
CONFIG_NET_CONFIG_MY_IPV4_ADDR="192.0.2.1"
CONFIG_NET_CONFIG_MY_IPV4_GW="192.0.2.2"
CONFIG_NET_CONFIG_PEER_IPV4_ADDR="192.0.2.2"

# WiFi playback
CONFIG_WIFI_OFFLOAD=y
CONFIG_NET_L2_WIFI_MGMT=y
CONFIG_NET_IF_MAX_IPV4_COUNT=2
```

## socs/native_64.overlay
```dts
#include "native.overlay"
```

## dts/bindings/wifi/golioth,wifi-playback.yaml
```yaml
# Copyright (c) 2024 Golioth, Inc.
# SPDX-License-Identifier: Apache-2.0

description: WiFi driver with playback of scanned WiFi networks

compatible: "golioth,wifi-playback"

include: base.yaml
```

## src/main.c
```c
/*
 * Copyright (c) 2024 Golioth, Inc.
 *
 * SPDX-License-Identifier: Apache-2.0
 */

#include <zephyr/logging/log.h>
LOG_MODULE_REGISTER(location_wifi_main, LOG_LEVEL_DBG);

#include <golioth/client.h>
#include <golioth/location/wifi.h>
#include <samples/common/sample_credentials.h>
#include <string.h>
#include <zephyr/net/wifi_mgmt.h>

#include <samples/common/net_connect.h>

#define APP_TIMEOUT_S 5

struct golioth_client *client;
static K_SEM_DEFINE(connected, 0, 1);

static void on_client_event(struct golioth_client *client,
                            enum golioth_client_event event,
                            void *arg)
{
    bool is_connected = (event == GOLIOTH_CLIENT_EVENT_CONNECTED);
    if (is_connected)
    {
        k_sem_give(&connected);
    }
    LOG_INF("Golioth client %s", is_connected ? "connected" : "disconnected");
}

static enum golioth_status golioth_location_wifi_append_zephyr(
    struct golioth_location_req *req,
    const struct wifi_scan_result *result)
{
    struct golioth_wifi_scan_result golioth_result = {
        .mac = {result->mac[0],
                result->mac[1],
                result->mac[2],
                result->mac[3],
                result->mac[4],
                result->mac[5]},
        .rssi = result->rssi,
    };

    return golioth_location_wifi_append(req, &golioth_result);
}

static struct golioth_location_req location_req;

static void wifi_scan_result_process(const struct wifi_scan_result *entry)
{
    if (entry->mac_length != WIFI_MAC_ADDR_LEN)
    {
        return;
    }

    golioth_location_wifi_append_zephyr(&location_req, entry);
}

static K_SEM_DEFINE(scan_sem, 0, 1);

static void wifi_scan_done_process(void)
{
    k_sem_give(&scan_sem);
}

static void wifi_mgmt_event_handler(struct net_mgmt_event_callback *cb,
                                    uint32_t mgmt_event,
                                    struct net_if *iface)
{
    switch (mgmt_event)
    {
        case NET_EVENT_WIFI_SCAN_RESULT:
            wifi_scan_result_process(cb->info);
            break;
        case NET_EVENT_WIFI_SCAN_DONE:
            wifi_scan_done_process();
            break;
        default:
            break;
    }
}

static int wifi_scan_and_get_location(struct net_if *iface)
{
    struct golioth_location_rsp location_rsp;
    enum golioth_status status;
    int err;

    golioth_location_init(&location_req);

    err = net_mgmt(NET_REQUEST_WIFI_SCAN, iface, NULL, 0);
    if (err)
    {
        LOG_ERR("Failed to scan: %d", err);
        return err;
    }

    k_sem_take(&scan_sem, K_FOREVER);

    status = golioth_location_finish(&location_req);
    if (status != GOLIOTH_OK)
    {
        if (status == GOLIOTH_ERR_NULL)
        {
            LOG_WRN("No location data to be provided");
            return 0;
        }

        LOG_ERR("Failed to encode location data");
        return 0;
    }

    status = golioth_location_get_sync(client, &location_req, &location_rsp, APP_TIMEOUT_S);
    if (status == GOLIOTH_OK)
    {
        LOG_INF("%s%lld.%09lld %s%lld.%09lld (%lld)",
                location_rsp.latitude < 0 ? "-" : "",
                llabs(location_rsp.latitude) / 1000000000,
                llabs(location_rsp.latitude) % 1000000000,
                location_rsp.longitude < 0 ? "-" : "",
                llabs(location_rsp.longitude) / 1000000000,
                llabs(location_rsp.longitude) % 1000000000,
                (long long int) location_rsp.accuracy);
    }

    return 0;
}

static struct net_mgmt_event_callback wifi_mgmt_cb;

int main(void)
{
    struct net_if *iface = net_if_get_first_wifi();

    LOG_DBG("Start WiFi location sample");

    net_mgmt_init_event_callback(&wifi_mgmt_cb,
                                 wifi_mgmt_event_handler,
                                 (NET_EVENT_WIFI_SCAN_RESULT | NET_EVENT_WIFI_SCAN_DONE));
    net_mgmt_add_event_callback(&wifi_mgmt_cb);

    net_connect();

    /* Note: In production, you would provision unique credentials onto each
     * device. For simplicity, we provide a utility to hardcode credentials as
     * kconfig options in the samples.
     */
    const struct golioth_client_config *client_config = golioth_sample_credentials_get();

    client = golioth_client_create(client_config);
    golioth_client_register_event_callback(client, on_client_event, NULL);

    k_sem_take(&connected, K_FOREVER);

    while (true)
    {
        wifi_scan_and_get_location(iface);
    }

    return 0;
}
```

## src/wifi_playback.c
```c
/*
 * Copyright (c) 2024 Golioth, Inc.
 *
 * SPDX-License-Identifier: Apache-2.0
 */

#include <zephyr/logging/log.h>
LOG_MODULE_REGISTER(wifi_playback, LOG_LEVEL_DBG);

#define DT_DRV_COMPAT golioth_wifi_playback

#include <zephyr/net/net_offload.h>
#include <zephyr/net/wifi_mgmt.h>

struct wifi_playback_scan_result
{
    uint8_t mac[WIFI_MAC_ADDR_LEN];
    int rssi;
};

struct wifi_playback_scan
{
    int64_t ts;
    const struct wifi_playback_scan_result *results;
    size_t num_results;
};

struct wifi_playback_config
{
    struct net_if *net_iface;
    const struct wifi_playback_scan *scans;
    size_t num_scans;
};

struct wifi_playback_data
{
    const struct wifi_playback_config *config;
    scan_result_cb_t scan_cb;
    struct k_work_delayable scan_work;
    size_t scan_idx;
};

#define SCAN_WORK_QUEUE_STACK_SIZE 2048

K_THREAD_STACK_DEFINE(scan_work_queue_stack_area, SCAN_WORK_QUEUE_STACK_SIZE);

static struct k_work_q scan_work_queue;

static void wifi_playback_scan_handle(struct k_work *work)
{
    struct k_work_delayable *dwork = k_work_delayable_from_work(work);
    struct wifi_playback_data *data = CONTAINER_OF(dwork, struct wifi_playback_data, scan_work);
    const struct wifi_playback_config *config = data->config;
    const struct wifi_playback_scan *scan = &config->scans[data->scan_idx];

    for (size_t i = 0; i < scan->num_results; i++)
    {
        struct wifi_scan_result scan_result = {};

        memcpy(scan_result.mac, scan->results[i].mac, WIFI_MAC_ADDR_LEN);
        scan_result.mac_length = WIFI_MAC_ADDR_LEN;

        scan_result.rssi = scan->results[i].rssi;

        data->scan_cb(config->net_iface, 0, &scan_result);
    }

    data->scan_cb(config->net_iface, 0, NULL);
    data->scan_cb = NULL;

    data->scan_idx++;
}

static int wifi_playback_mgmt_scan(const struct device *dev,
                                   struct wifi_scan_params *params,
                                   scan_result_cb_t cb)
{
    const struct wifi_playback_config *config = dev->config;
    struct net_if *net_iface = config->net_iface;
    struct wifi_playback_data *data = dev->data;
    const struct wifi_playback_scan *scan = &config->scans[data->scan_idx];

    ARG_UNUSED(params);

    if (!net_if_is_carrier_ok(net_iface))
    {
        return -EIO;
    }

    data->scan_cb = cb;

    if (scan->ts == SYS_FOREVER_MS)
    {
        LOG_INF("No more WiFi scans");
        return 0;
    }

    k_work_schedule_for_queue(
        &scan_work_queue,
        &data->scan_work,
        K_TIMEOUT_ABS_MS(scan->ts * 1000 / CONFIG_GOLIOTH_WIFI_PLAYBACK_SPEED_FACTOR));

    return 0;
}

static int wifi_playback_mgmt_iface_status(const struct device *dev,
                                           struct wifi_iface_status *status)
{
    const struct wifi_playback_config *config = dev->config;
    struct net_if *net_iface = config->net_iface;

    memset(status, 0x0, sizeof(*status));

    status->state = WIFI_STATE_INACTIVE;
    status->band = WIFI_FREQ_BAND_UNKNOWN;
    status->iface_mode = WIFI_MODE_UNKNOWN;
    status->link_mode = WIFI_LINK_MODE_UNKNOWN;
    status->security = WIFI_SECURITY_TYPE_UNKNOWN;
    status->mfp = WIFI_MFP_UNKNOWN;

    if (!net_if_is_carrier_ok(net_iface))
    {
        status->state = WIFI_STATE_INTERFACE_DISABLED;
        return 0;
    }

    return 0;
}

static const struct wifi_mgmt_ops wifi_playback_mgmt_ops = {
    .scan = wifi_playback_mgmt_scan,
    .iface_status = wifi_playback_mgmt_iface_status,
};

static struct net_offload wifi_playback_net_offload;

static void wifi_playback_iface_init(struct net_if *iface)
{
    iface->if_dev->offload = &wifi_playback_net_offload;

    net_if_flag_set(iface, NET_IF_NO_AUTO_START);

    /* Not currently connected to a network */
    net_if_dormant_on(iface);
}

static enum offloaded_net_if_types wifi_playback_offload_get_type(void)
{
    return L2_OFFLOADED_NET_IF_TYPE_WIFI;
}

static const struct net_wifi_mgmt_offload wifi_playback_api = {
    .wifi_iface.iface_api.init = wifi_playback_iface_init,
    .wifi_iface.get_type = wifi_playback_offload_get_type,
    .wifi_mgmt_api = &wifi_playback_mgmt_ops,
};

static int wifi_playback_init(const struct device *dev)
{
    const struct wifi_playback_config *config = dev->config;
    struct wifi_playback_data *data = dev->data;

    data->config = config;
    k_work_init_delayable(&data->scan_work, wifi_playback_scan_handle);

    k_work_queue_init(&scan_work_queue);
    k_work_queue_start(&scan_work_queue,
                       scan_work_queue_stack_area,
                       K_THREAD_STACK_SIZEOF(scan_work_queue_stack_area),
                       K_HIGHEST_THREAD_PRIO,
                       NULL);

    return 0;
}

static const struct wifi_playback_config wifi_playback_config_0;

static struct wifi_playback_data wifi_playback_data_0;

NET_DEVICE_DT_INST_OFFLOAD_DEFINE(0,
                                  wifi_playback_init,
                                  NULL,
                                  &wifi_playback_data_0,
                                  &wifi_playback_config_0,
                                  CONFIG_WIFI_INIT_PRIORITY,
                                  &wifi_playback_api,
                                  NET_ETH_MTU);

#include "wifi_playback_input.c"

static const struct wifi_playback_config wifi_playback_config_0 = {
    .net_iface = NET_IF_GET(Z_DEVICE_DT_DEV_ID(DT_DRV_INST(0)), 0),
    .scans = scan_results,
    .num_scans = ARRAY_SIZE(scan_results),
};
```
