## port/zephyr/Kconfig
```kconfig
# Copyright (c) 2023 Golioth, Inc.
# SPDX-License-Identifier: Apache-2.0

module = GOLIOTH
module-str = Golioth

menuconfig GOLIOTH_FIRMWARE_SDK
	bool "Golioth Firmware SDK"
	select COAP
	select ZVFS_EVENTFD
	select REBOOT if BOOTLOADER_MCUBOOT
	select REQUIRES_FULL_LIBC
	select MBEDTLS
	select MBEDTLS_DTLS if MBEDTLS_BUILTIN
	select MBEDTLS_TLS_LIBRARY if NRF_SECURITY
	select MBEDTLS_SSL_PROTO_DTLS if NRF_SECURITY
	select MBEDTLS_SSL_EXTENDED_MASTER_SECRET
	select NET_SOCKETS
	select NET_UDP
	select ZCBOR
	imply DNS_RESOLVER if NET_NATIVE
	imply NET_SOCKETS_SOCKOPT_TLS
	imply NET_SOCKETS_ENABLE_DTLS
	help
	  Enable library for communication with Golioth cloud.

if GOLIOTH_FIRMWARE_SDK

source "${ZEPHYR_GOLIOTH_FIRMWARE_SDK_MODULE_DIR}/src/Kconfig"

menu "Authentication"

source "${ZEPHYR_GOLIOTH_FIRMWARE_SDK_MODULE_DIR}/src/Kconfig.authentication"

config GOLIOTH_USE_CONNECTION_ID
	bool "Use DTLS 1.2 Connection IDs"
	select MBEDTLS_SSL_DTLS_CONNECTION_ID
	help
	  Use DTLS 1.2 Connection IDs. Connection IDs replace IP
	  addresses as the session identifier, and can be used to
	  reduce the number of handshakes a device has to make in
	  certain scenarios.

config GOLIOTH_AUTH_PSK_MBEDTLS_DEPS
	bool "mbedTLS dependencies for PSK auth"
	depends on MBEDTLS_BUILTIN || NRF_SECURITY
	# Select at least one server supported cipher
	imply MBEDTLS_CIPHER_GCM_ENABLED if (MBEDTLS_BUILTIN && !MBEDTLS_CIPHER_CCM_ENABLED && !MBEDTLS_CIPHER_CBC_MODE_ENABLED)
	imply MBEDTLS_GCM_C if (NRF_SECURITY && !MBEDTLS_CCM_C)
	select MBEDTLS_KEY_EXCHANGE_PSK_ENABLED
	# Satisfy build-time check of MBEDTLS_PK_C (needs MBEDTLS_ECP_C || MBEDTLS_RSA_C)
	imply MBEDTLS_ECP_C if (NRF_SECURITY && !MBEDTLS_RSA_C)
	help
	  Select mbedTLS dependencies for PSK based authentication.

	  This is a convenience option when using mbedTLS as a library to make
	  (D)TLS connection with Golioth cloud.

config GOLIOTH_AUTH_CERT_MBEDTLS_DEPS
	bool "mbedTLS dependencies for certificate based auth"
	depends on MBEDTLS_BUILTIN || NRF_SECURITY
	# Enable P-256 and P-384 for broad compatibility. Disabling these curves
	# may cause incompatibility with Golioth servers, now or in the future.
	imply MBEDTLS_ECP_DP_SECP256R1_ENABLED
	imply MBEDTLS_ECP_DP_SECP384R1_ENABLED
	# Hashes
	imply MBEDTLS_SHA256
	imply MBEDTLS_SHA384
	# Select at least one server supported cipher
	imply MBEDTLS_CIPHER_GCM_ENABLED if (MBEDTLS_BUILTIN && !MBEDTLS_CIPHER_CCM_ENABLED)
	select MBEDTLS_GCM_C if (NRF_SECURITY && !MBEDTLS_CCM_C)
	select MBEDTLS_ECP_C
	select MBEDTLS_ECDH_C
	select MBEDTLS_ECDSA_C
	select MBEDTLS_RSA_C
	select MBEDTLS_KEY_EXCHANGE_ECDHE_ECDSA_ENABLED
	help
	  Select mbedTLS dependencies for certificate based authentication.

	  This is a convenience option when using mbedTLS as a library to make
	  (D)TLS connection with Golioth cloud.

config MBEDTLS_MPI_MAX_SIZE
	int
	default 512 if GOLIOTH_AUTH_CERT_MBEDTLS_DEPS

config GOLIOTH_CIPHERSUITES
	string "Ciphersuites"
	# Select single PSK ciphersuite (following ciphersuite preference in mbedTLS)
	default "TLS_PSK_WITH_AES_128_GCM_SHA256" if (GOLIOTH_AUTH_METHOD_PSK && MBEDTLS_BUILTIN && MBEDTLS_CIPHER_GCM_ENABLED)
	default "TLS_PSK_WITH_AES_128_CCM" if (GOLIOTH_AUTH_METHOD_PSK && MBEDTLS_BUILTIN && MBEDTLS_CIPHER_CCM_ENABLED)
	default "TLS_PSK_WITH_AES_128_CBC_SHA256" if (GOLIOTH_AUTH_METHOD_PSK && MBEDTLS_BUILTIN && MBEDTLS_CIPHER_MODE_CBC_ENABLED)
	# Same, but for NCS flavour of mbedTLS
	default "TLS_PSK_WITH_AES_128_GCM_SHA256" if (GOLIOTH_AUTH_METHOD_PSK && ZEPHYR_NRF_MODULE && MBEDTLS_TLS_LIBRARY && MBEDTLS_GCM_C)
	default "TLS_PSK_WITH_AES_128_CCM" if (GOLIOTH_AUTH_METHOD_PSK && ZEPHYR_NRF_MODULE && MBEDTLS_TLS_LIBRARY && MBEDTLS_CCM_C)
	default "TLS_PSK_WITH_AES_128_CBC_SHA256" if (GOLIOTH_AUTH_METHOD_PSK && ZEPHYR_NRF_MODULE && MBEDTLS_TLS_LIBRARY && MBEDTLS_CIPHER_MODE_CBC)
	# Select all supported PSK ciphersuites if not using MBEDTLS_BUILTIN
	default "TLS_PSK_WITH_AES_128_GCM_SHA256 TLS_PSK_WITH_AES_128_CCM TLS_PSK_WITH_AES_128_CBC_SHA256 TLS_PSK_WITH_AES_128_CCM_8" if GOLIOTH_AUTH_METHOD_PSK
	# Select single cert-based ciphersuite (following ciphersuite preference in mbedTLS)
	default "TLS_ECDHE_ECDSA_WITH_AES_128_GCM_SHA256" if (GOLIOTH_AUTH_METHOD_CERT && MBEDTLS_BUILTIN && MBEDTLS_CIPHER_GCM_ENABLED)
	default "TLS_ECDHE_ECDSA_WITH_AES_128_CCM" if (GOLIOTH_AUTH_METHOD_CERT && MBEDTLS_BUILTIN && MBEDTLS_CIPHER_CCM_ENABLED)
	# Same, but for NCS flavour of mbedTLS
	default "TLS_ECDHE_ECDSA_WITH_AES_128_GCM_SHA256" if (GOLIOTH_AUTH_METHOD_CERT && ZEPHYR_NRF_MODULE && MBEDTLS_TLS_LIBRARY && MBEDTLS_GCM_C)
	default "TLS_ECDHE_ECDSA_WITH_AES_128_CCM" if (GOLIOTH_AUTH_METHOD_CERT && ZEPHYR_NRF_MODULE && MBEDTLS_TLS_LIBRARY && MBEDTLS_CCM_C)
	# Select all supported cert-based ciphersuites if not using MBEDTLS_BUILTIN
	default "TLS_ECDHE_ECDSA_WITH_AES_128_GCM_SHA256 TLS_ECDHE_ECDSA_WITH_AES_128_CCM TLS_ECDHE_ECDSA_WITH_AES_128_CCM_8" if GOLIOTH_AUTH_METHOD_CERT
	help
	  Ciphersuite list used during (D)TLS handshakes. Default value contains currently supported
	  ciphersuites by Golioth server.

	  Use string representations of ciphersuites as defined by IANA in:
	  https://www.iana.org/assignments/tls-parameters/tls-parameters.xhtml

	  Select single ciphersuite to reduce data exchanged during (D)TLS handshake, due to reduced
	  ciphersuite list in Client Hello message.

	  Make sure that credentials (e.g. using Zephyr TLS credentials subsystem) are configured
	  for each ciphersuite (e.g. PSKs for PSK-based ciphersuites or certificates for
	  certificate-based ciphersuites) that is negotiated.

	  If empty, then underlying TLS implementation (e.g. mbedTLS library) decides which
	  ciphersuites to use. Relying on that is not recommended!

config GOLIOTH_COAP_CLIENT_CREDENTIALS_TAG
	int "TLS credentials secure tag"
	default 515765868
	help
	  Secure tag, which is a reference to TLS credential. This value is
	  configured on created (D)TLS socket in order reference credentials
	  used during connection handshake.

	  See 'sec_tag_t' typedef in Zephyr for details.

config GOLIOTH_COAP_CLIENT_SECONDARY_CA_CREDENTIALS_TAG
    int "Secondary CA Cert TLS credentials secure tag"
    depends on GOLIOTH_SECONDARY_CA_CRT
    default 515765869
    help
      Secure tag for the secondary CA certificate

config GOLIOTH_HOSTNAME_VERIFICATION
	bool "Hostname verification"
	default y if GOLIOTH_AUTH_METHOD_CERT
	help
	  Enable hostname verification on (D)TLS layer.

if GOLIOTH_HOSTNAME_VERIFICATION

config GOLIOTH_HOSTNAME_VERIFICATION_SKIP
	bool "(development only) Skip hostname verification"
	help
	  Skip TLS layer hostname verification, by passing NULL to
	  zsock_setsockopt(..., SOL_TLS, TLS_HOSTNAME, ...).

	  Use this only for development with self-hosted server.

endif # GOLIOTH_HOSTNAME_VERIFICATION

config GOLIOTH_HARDCODED_CA_CRT_PATH
    default "${ZEPHYR_GOLIOTH_FIRMWARE_SDK_MODULE_DIR}/src/isrgrootx1.der"

config GOLIOTH_HARDCODED_SECONDARY_CA_CRT_PATH
    default "${ZEPHYR_GOLIOTH_FIRMWARE_SDK_MODULE_DIR}/src/goliothrootx1.der"

endmenu # authentication

menu "CoAP"

source "${ZEPHYR_GOLIOTH_FIRMWARE_SDK_MODULE_DIR}/src/Kconfig.coap"

config GOLIOTH_COAP_MAX_PATH_LEN
    int
    default COAP_EXTENDED_OPTIONS_LEN_VALUE if COAP_EXTENDED_OPTIONS_LEN
    default 12
    help
        Maximum length of a CoAP path (everything after "coaps://coap.golioth.io/"). Increase this
        value by setting two symbols provided by the Zephyr CoAP library:

          - CONFIG_COAP_EXTENDED_OPTIONS_LEN=y
          - CONFIG_COAP_EXTENDED_OPTIONS_LEN_VALUE=39


config GOLIOTH_COAP_CLIENT_RX_TIMEOUT_SEC
	int "Receive timeout (seconds)"
	default 30
	help
	  Receive timeout, after which connection will be reestablished.

config GOLIOTH_COAP_CLIENT_RX_BUF_SIZE
	int "Receive buffer size"
	default 1280
	help
	  Size of receive buffer, which is used for reading data from network
	  socket.

endmenu # CoAP Settings

menu "Logging"

source "subsys/logging/Kconfig.template.log_config"

config LOG_BACKEND_GOLIOTH
	bool "Golioth logging backend"
	depends on LOG
	depends on !LOG_MODE_IMMEDIATE
	depends on GOLIOTH_FIRMWARE_SDK
	select LOG_OUTPUT
	select ZCBOR
	help
	  Enable sending logs to Golioth cloud.

if LOG_BACKEND_GOLIOTH

config LOG_BACKEND_GOLIOTH_MAX_LOG_STRING_SIZE
	int "Maximum length of a formatted log string"
	default 256
	help
	  Specified maximum buffer size used for storing a formatted log
	  string before sending to Golioth cloud.

endif # LOG_BACKEND_GOLIOTH

source "${ZEPHYR_GOLIOTH_FIRMWARE_SDK_MODULE_DIR}/src/Kconfig.logging"

endmenu # Logging

rsource '${ZEPHYR_GOLIOTH_FIRMWARE_SDK_MODULE_DIR}/examples/zephyr/common/Kconfig'

config GOLIOTH_ZEPHYR_THREAD_STACKS
	int "Number of thread stacks in Zephyr pool"
	default 2
	help
	  Number of thread stacks statically allocated for the use in golioth_sys_thread_create().

config GOLIOTH_ZEPHYR_THREAD_STACK_SIZE
	int "Thread stack sizes in Zephyr pool"
	default GOLIOTH_COAP_THREAD_STACK_SIZE
	help
	  Threads stacks sizes for the use in golioth_sys_thread_create().

menuconfig GOLIOTH_SHOW_VERSION_BOOT_MSG
	bool "Show the Golioth Firmware SDK version at boot"
	default y
    help
      Automatically display the Golioth Firmware SDK version in the device's console output during
      boot.

if GOLIOTH_SHOW_VERSION_BOOT_MSG

config GOLIOTH_VERSION_INCLUDE_COMMIT
    bool "Include the commit hash in the version message"
    default y
    help
      Show the commit has in addition to the SDK version (eg: 0.16.0-34-ga4e5523debf1)

endif # GOLIOTH_SHOW_VERSION_BOOT_MSG
endif # GOLIOTH_FIRMWARE_SDK
```

## src/Kconfig
```kconfig
#
# Copyright (C) 2022 Golioth, Inc.
#
# SPDX-License-Identifier: Apache-2.0
#

config GOLIOTH_OTA
    bool "Golioth Over-the-Air Update Service"
    help
        Enable the Golioth OTA service to manage the transfer of OTA components between server and
        device. See also: GOLIOTH_FW_UPDATE

if GOLIOTH_OTA

config GOLIOTH_OTA_MAX_PACKAGE_NAME_LEN
    int "Golioth maximum OTA component package name length"
    default 16
    help
        Maximum number of characters in the package name of a single
        OTA component.

config GOLIOTH_OTA_MAX_VERSION_LEN
    int "Golioth maximum OTA component version length"
    default 16
    help
        Maximum number of characters in the version string of a single
        OTA component.

config GOLIOTH_OTA_MAX_NUM_COMPONENTS
    int "Golioth maximum OTA number of components"
    default 1
    help
        Maximum number of components in an OTA manifest.

config GOLIOTH_OTA_MANIFEST_SUBSCRIPTION_POLL_INTERVAL_S
    int "Polling period for fetching OTA manifest"
    default 86400
    help
        The maximum period to wait between fetching the OTA manifest. Devices may receive a
        manifest sooner if they are notified directly by Golioth. A value of 0 will disable
        the periodic fetch and rely solely on notifications from Golioth.

endif # GOLIOTH_OTA

config GOLIOTH_GATEWAY
    bool "EXPERIMENTAL: Golioth Gateway service"
    help
        Enable the Golioth Gateway service for proxying pouches

config GOLIOTH_LIGHTDB_STATE
    bool "Golioth LightDB State service"
    help
        Enable the Golioth LightDB State service

if GOLIOTH_LIGHTDB_STATE

config GOLIOTH_LIGHTDB_STATE_FLOAT_HELPERS
    bool "Helper functions for working with floats in LightDB State"
    help
        The SDk provides helper functions for getting and setting
        individual values of various types in LightDB State. This enables
        the helper functions for float types.

endif # GOLIOTH_LIGHTDB_STATE

config GOLIOTH_NET_INFO
    bool "Golioth network information"

if GOLIOTH_NET_INFO

config GOLIOTH_NET_INFO_BUFFER_SIZE
    int "Golioth network information buffer size"
    default 2048
    help
        Size of buffer for Golioth network information. It determines how much information
        (like Wi-Fi Access Points) might be provided in the network information.

config GOLIOTH_NET_INFO_CELLULAR
    bool "Golioth network information cellular support"
    help
        Network information construction using cellular network.

config GOLIOTH_NET_INFO_WIFI
    bool "Golioth network information Wi-Fi support"
    help
        Network information construction using Wi-Fi scanning.

endif # GOLIOTH_NET_INFO

config GOLIOTH_STREAM
    bool "Golioth Stream service"
    help
        Enable the Golioth Stream service

config GOLIOTH_RPC
    bool "Golioth RPC service"
    help
        Enable the Golioth RPC service

if GOLIOTH_RPC

config GOLIOTH_RPC_MAX_NUM_METHODS
    int "Maximum number of registered Golioth RPC methods"
    default 8
    help
        Maximum number of Golioth Remote Procedure Call methods that can
        be registered.

config GOLIOTH_RPC_MAX_RESPONSE_LEN
    int "Maximum number of bytes to allocate for RPC response payload"
    default 256
    help
        Maximum number of bytes to allocate for the Golioth remote procedure call response payload.
        This value determines the memory available for the response_detail_map passed to the RPC
        callback.

endif # GOLIOTH_RPC

config GOLIOTH_SETTINGS
    bool "Golioth Settings service"
    help
        Enable the Golioth Settings service

if GOLIOTH_SETTINGS

config GOLIOTH_SETTINGS_MAX_RESPONSE_LEN
    int "Maximum number of bytes to allocate for Settings response payload"
    default 256
    help
        Maximum number of bytes to allocate for the Golioth Settings service response payload. This
        value determines the memory available for the response_detail_map which is used to pass sync
        information like error codes back to the server. If you have a number of settings that are
        not in sync (wrong value, wrong type, out of bounds, etc.), increase this value to resolve
        `golioth_settings: Failed to send a response to server: -12` errors.

config GOLIOTH_MAX_NUM_SETTINGS
    int "Max number of Golioth settings"
    default 16
    help
        Maximum number of Golioth settings which can be registered
        by the application.

endif # GOLIOTH_SETTINGS

config GOLIOTH_PKI
    bool "Golioth Public Key Infrastructure service"
    help
        Enable the Golioth Public Key Infrastructure service
```

## src/Kconfig.authentication
```kconfig
#
# Copyright (C) 2024 Golioth, Inc.
#
# SPDX-License-Identifier: Apache-2.0
#

choice GOLIOTH_AUTH_METHOD
    prompt "Authentication method support"

config GOLIOTH_AUTH_METHOD_PSK
    bool "PSK-ID / PSK only"
    imply GOLIOTH_AUTH_PSK_MBEDTLS_DEPS
    help
      Only PSK based authentication will be supported.

config GOLIOTH_AUTH_METHOD_CERT
    bool "Certificate based only"
    imply GOLIOTH_AUTH_CERT_MBEDTLS_DEPS
    help
      Only certificate based authentication will be supported.

endchoice

if GOLIOTH_AUTH_METHOD_CERT

config GOLIOTH_HARDCODED_CA_CRT_PATH
    string "Server CA certificate path"
    help
      Path to a certificate that will be used to authenticate the server

config GOLIOTH_SECONDARY_CA_CRT
    bool "Include a secondary CA certificate"
    default y
    help
      Include a second CA certificate. Disabling this option can result in
      devices being unable to connect to Golioth, either now or in the
      future, without warning.

if GOLIOTH_SECONDARY_CA_CRT

config GOLIOTH_HARDCODED_SECONDARY_CA_CRT_PATH
    string "Secondary Server CA certificate path"
    help
      Path to a secondary certificate that will be used to authenticate
      the server.

endif

endif
```
