## examples/zephyr/common/Kconfig.defconfig
```kconfig
#
# Copyright (C) 2022-2023 Golioth, Inc.
#
# SPDX-License-Identifier: Apache-2.0
#

if GOLIOTH_SAMPLE_COMMON

if SOC_ESP32

# Force ESP32 WiFi to use system heap
config ESP_HEAP_RUNTIME
	bool
	default n

endif # SOC_ESP32

if DNS_RESOLVER

config DNS_SERVER_IP_ADDRESSES
	default y

config DNS_SERVER1
	default "1.1.1.1"

endif # DNS_RESOLVER

configdefault ZVFS_EVENTFD_MAX
	int
	default 14 if GOLIOTH_OTA
    default 13 if GOLIOTH_LOCATION_CELLULAR && GOLIOTH_LOCATION_WIFI
	default 7

if LOG_BACKEND_GOLIOTH

config LOG_PROCESS_THREAD_STACK_SIZE
    default 1536

endif # LOG_BACKEND_GOLIOTH

if MBEDTLS

config MBEDTLS_ENABLE_HEAP
	default y

if MBEDTLS_ENABLE_HEAP

config MBEDTLS_HEAP_SIZE
	default 49152 if GOLIOTH_AUTH_METHOD_CERT
	default 10240

endif # MBEDTLS_ENABLE_HEAP

configdefault NET_SOCKETS_DTLS_MAX_FRAGMENT_LENGTH
	default 4096 if GOLIOTH_AUTH_METHOD_CERT
	default 2048

if MBEDTLS_BUILTIN

config MBEDTLS_SSL_MAX_CONTENT_LEN
	default 4096 if GOLIOTH_AUTH_METHOD_CERT
	default 2048

endif # MBEDTLS_BUILTIN

if NRF_SECURITY

config MBEDTLS_SSL_IN_CONTENT_LEN
	int
	default 4096 if GOLIOTH_AUTH_METHOD_CERT
	default 2048

config MBEDTLS_SSL_OUT_CONTENT_LEN
	int
	default 4096 if GOLIOTH_AUTH_METHOD_CERT
	default 2048

endif # NRF_SECURITY

endif # MBEDTLS

if ZEPHYR_NRF_MODULE

config NEWLIB_LIBC_FLOAT_PRINTF
	default y if NEWLIB_LIBC && GOLIOTH_LIGHTDB_STATE_FLOAT_HELPERS

endif # ZEPHYR_NRF_MODULE

if !ZEPHYR_NRF_MODULE

config REQUIRES_FLOAT_PRINTF
	bool
	default y if GOLIOTH_LIGHTDB_STATE_FLOAT_HELPERS

endif # !ZEPHYR_NRF_MODULE

config NETWORKING
	default y

config NET_IPV4
	default y

config NET_IPV6
	default n

config NET_LOG
	default y if NETWORKING

config NET_SHELL
	default y if NETWORKING

config NET_BUF_TX_COUNT
	default 32 if GOLIOTH_AUTH_METHOD_CERT && WIFI_ESP_AT

config MAIN_STACK_SIZE
	default 4096

configdefault ZVFS_OPEN_MAX
	int
	default 23 if GOLIOTH_OTA
    default 20 if GOLIOTH_LOCATION_CELLULAR && GOLIOTH_LOCATION_WIFI
	default 16

config REBOOT
	default y

config GOLIOTH_COAP_HOST_URI
	default "$(GOLIOTH_COAP_HOST_URI)" if "$(GOLIOTH_COAP_HOST_URI)" != ""

config FLASH
	default y

config FLASH_MAP
	default y

config NVS
	default y

config SETTINGS
	default y

config SETTINGS_RUNTIME
	default y

configdefault COAP_EXTENDED_OPTIONS_LEN
    default y

configdefault COAP_EXTENDED_OPTIONS_LEN_VALUE
    default 39

if GOLIOTH_SAMPLE_TWISTER_TEST

configdefault GOLIOTH_SAMPLE_NRF91_RESET_LOOP_OVERRIDE
	bool
	default y

configdefault LOG_BACKEND_NATIVE_POSIX
	bool
	default n

configdefault SHELL_BACKEND_SERIAL_RX_RING_BUFFER_SIZE
	int
	default 128

configdefault SHELL_DEFAULT_TERMINAL_WIDTH
	int
	default 100

choice GOLIOTH_SAMPLE_CREDENTIALS
	default GOLIOTH_SAMPLE_CREDENTIALS_SETTINGS if (GOLIOTH_AUTH_METHOD_PSK && SETTINGS)
endchoice

config GOLIOTH_FW_UPDATE_PACKAGE_NAME
   default BOARD if GOLIOTH_FW_UPDATE

endif # GOLIOTH_SAMPLE_TWISTER_TEST

configdefault MCUMGR_TRANSPORT_NETBUF_USER_DATA_SIZE
	default 112 if NET_NATIVE_OFFLOADED_SOCKETS

endif # GOLIOTH_SAMPLE_COMMON
```

## examples/zephyr/golioth_basics/Kconfig
```kconfig
# Copyright (c) 2021 Golioth, Inc.
# SPDX-License-Identifier: Apache-2.0

configdefault ZVFS_EVENTFD_MAX
	int
	default 15

configdefault ZVFS_OPEN_MAX
	int
	default 25

configdefault EVENTFD_MAX
	int
	default 15

configdefault POSIX_MAX_FDS
	int
	default 25

source "${ZEPHYR_GOLIOTH_FIRMWARE_SDK_MODULE_DIR}/examples/zephyr/common/Kconfig.defconfig"

source "Kconfig.zephyr"
```

## examples/zephyr/golioth_basics/boards/nrf9160dk_nrf9160_ns.conf
```kconfig
# General config
CONFIG_HEAP_MEM_POOL_SIZE=4096
CONFIG_NEWLIB_LIBC=y

# Networking
CONFIG_NET_SOCKETS_OFFLOAD=y
CONFIG_NET_IPV6=y
CONFIG_NET_IPV6_NBR_CACHE=n
CONFIG_NET_IPV6_MLD=n

# Increase native TLS socket implementation, so that it is chosen instead of
# offloaded nRF91 sockets
CONFIG_NET_SOCKETS_TLS_PRIORITY=35

# Modem library
CONFIG_NRF_MODEM_LIB=y
CONFIG_NRF_MODEM_LIB_ON_FAULT_APPLICATION_SPECIFIC=y

# LTE connectivity with network connection manager
CONFIG_LTE_CONNECTIVITY=y
CONFIG_NET_CONNECTION_MANAGER=y
CONFIG_NET_CONNECTION_MANAGER_STACK_SIZE=1024

# Increased sysworkq size, due to LTE connectivity
CONFIG_SYSTEM_WORKQUEUE_STACK_SIZE=2048

# Disable options y-selected by NCS for no good reason
CONFIG_MBEDTLS_KEY_EXCHANGE_DHE_PSK_ENABLED=n
CONFIG_MBEDTLS_KEY_EXCHANGE_DHE_RSA_ENABLED=n

# Generate MCUboot compatible images
CONFIG_BOOTLOADER_MCUBOOT=y
```

## examples/zephyr/golioth_basics/sample.yaml
```yaml
sample:
  name: Golioth Basics Example
common:
  build_only: true
tests:
  sample.golioth.basics:
    platform_allow: >
      esp32_devkitc_wrover/esp32/procpu
      mimxrt1024_evk
      nrf52840dk/nrf52840
      nrf9160dk/nrf9160/ns
      rak5010/nrf52840
      qemu_x86
  sample.golioth.basics.sysbuild:
    sysbuild: true
    platform_allow: >
      nrf52840dk/nrf52840
```

## examples/zephyr/lightdb/observe/boards/rpi_pico2_rp2350a_m33_w.conf
```kconfig
CONFIG_NETWORKING=y
CONFIG_TEST_RANDOM_GENERATOR=y

CONFIG_NET_DHCPV4=y

CONFIG_NET_IPV4=y
CONFIG_NET_IPV6=n

CONFIG_WIFI=y
CONFIG_WIFI_LOG_LEVEL_ERR=y
CONFIG_NET_L2_WIFI_SHELL=y
CONFIG_GOLIOTH_SAMPLE_WIFI=y
```

## examples/zephyr/lightdb/observe/sample.yaml
```yaml
sample:
  description: Use LightDB observe
  name: lightdb-observe
common:
  harness: pytest
  tags:
    - golioth
    - lightdb
    - socket
    - goliothd
tests:
  sample.golioth.lightdb_observe:
    timeout: 180
    extra_configs:
      - CONFIG_GOLIOTH_SAMPLE_TWISTER_TEST=y
      - arch:posix:CONFIG_NATIVE_UART_0_ON_STDINOUT=y
    platform_allow:
      - esp32_devkitc_wrover/esp32/procpu
      - frdm_rw612
      - native_sim
      - native_sim/native/64
      - nrf52840dk/nrf52840
      - nrf9160dk/nrf9160/ns
      - nucleo_h563zi/stm32h563xx
      - rak5010/nrf52840
```

## examples/zephyr/stream/boards/rak5010_nrf52840.conf
```kconfig
CONFIG_UART_ASYNC_API=y
CONFIG_MODEM_CELLULAR_APN="internet"

# USB
CONFIG_USB_DEVICE_STACK=y
CONFIG_USB_DEVICE_PRODUCT="RAK5010 Zephyr"
CONFIG_USB_DEVICE_PID=0x0004
CONFIG_USB_DEVICE_INITIALIZE_AT_BOOT=y

CONFIG_UART_CONSOLE=y
CONFIG_UART_LINE_CTRL=y
CONFIG_LOG_BACKEND_RTT=n
CONFIG_USB_CDC_ACM_LOG_LEVEL_OFF=y

# Networking
CONFIG_NETWORKING=y
CONFIG_NET_NATIVE=y
CONFIG_NET_L2_PPP=y
CONFIG_NET_IPV4=y
CONFIG_NET_UDP=y
CONFIG_NET_SOCKETS=y
CONFIG_NET_CONTEXT_RCVTIMEO=y

# Modem driver
CONFIG_MODEM=y
CONFIG_MODEM_CELLULAR=y
```

## port/esp_idf/components/coap/Kconfig
```kconfig
#
# Copyright (C) 2024 Golioth, Inc.
#
# SPDX-License-Identifier: Apache-2.0
#

config LIBCOAP_ENABLE_IPV6_SUPPORT
    bool "Enable libcoap IPv6 support"
    help
        Compile in libcoap IPv6 support.
```

## port/esp_idf/components/golioth_sdk/Kconfig
```kconfig
#
# Copyright (C) 2022 Golioth, Inc.
#
# SPDX-License-Identifier: Apache-2.0
#

menu "Golioth SDK Configuration"

rsource '../../../../src/Kconfig'

menu "Authentication"

rsource '../../../../src/Kconfig.authentication'

endmenu # Authentication

menu "CoAP"

rsource '../../../../src/Kconfig.coap'

config GOLIOTH_COAP_MAX_PATH_LEN
    int "Golioth maximum CoAP path length"
    default 39
    help
        Maximum length of a CoAP path (everything after
        "coaps://coap.golioth.io/").

endmenu # CoAP

menu "Logging"

rsource '../../../../src/Kconfig.logging'

endmenu # Logging

endmenu # Golioth SDK Configuration
```
