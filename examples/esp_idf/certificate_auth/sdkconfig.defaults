## examples/esp_idf/certificate_auth/sdkconfig.defaults
```kconfig
CONFIG_MBEDTLS_SSL_PROTO_DTLS=y
CONFIG_MBEDTLS_PSK_MODES=y
CONFIG_MBEDTLS_KEY_EXCHANGE_PSK=y
CONFIG_MBEDTLS_TLS_CLIENT_ONLY=y
CONFIG_LWIP_NETBUF_RECVINFO=y
CONFIG_FREERTOS_USE_TRACE_FACILITY=y
CONFIG_FREERTOS_USE_STATS_FORMATTING_FUNCTIONS=y

# Default sdkconfig parameters to use the OTA
# partition table layout, with a 4MB flash size
CONFIG_ESPTOOLPY_FLASHSIZE_4MB=y
CONFIG_PARTITION_TABLE_TWO_OTA=y

# If the new app firmware does not cancel the rollback,
# then this will ensure that rollback happens automatically
# if/when the device is next rebooted.
CONFIG_BOOTLOADER_APP_ROLLBACK_ENABLE=y

CONFIG_ESP_SYSTEM_PANIC_PRINT_HALT=y
CONFIG_LOG_DEFAULT_LEVEL_DEBUG=y

# GLTH_LOGX statements will automatically upload to Golioth Logs service
CONFIG_GOLIOTH_AUTO_LOG_TO_CLOUD=1
CONFIG_GOLIOTH_COAP_REQUEST_QUEUE_MAX_ITEMS=20
```

## examples/esp_idf/common/Kconfig
```kconfig
#
# Copyright (C) 2024 Golioth, Inc.
#
# SPDX-License-Identifier: Apache-2.0
#

menu "Common helper configurations shared across multiple samples"

config GOLIOTH_SAMPLE_HARDCODED_CREDENTIALS
    bool "Hardcoded credentials"
    help
        Use hardcoded credentials in samples

if GOLIOTH_SAMPLE_HARDCODED_CREDENTIALS

config GOLIOTH_SAMPLE_PSK_ID
    string "Golioth PSK-ID"
    help
        Defines PSK ID used during DTLS handshake with Golioth server.

config GOLIOTH_SAMPLE_PSK
    string "Golioth PSK"
    help
        Defines PSK used during DTLS handshake with Golioth server.

endif # GOLIOTH_SAMPLE_HARDCODED_CREDENTIALS

endmenu # Common helper configurations shared across multiple samples
```

## examples/esp_idf/fw_update/main/Kconfig
```kconfig
config GOLIOTH_FW_UPDATE_PACKAGE_NAME
    string "Package name of the main firmware component"
    default "main"
    help
      The Package Name used by the Golioth Cloud to indicate the binary to use for device firmware
      update. This name must be no more than GOLIOTH_OTA_MAX_PACKAGE_NAME_LEN characters in length.

config GOLIOTH_FW_UPDATE_OBSERVATION_RETRY_MAX_DELAY_S
    int "Golioth maximum delay before retrying firmware OTA manifest observation"
    default 300 # 5 minutes
    help
        Maximum number of seconds to delay between attempts to establish an OTA manifest
        observation.

        When registering an observation for firmware updates fails, a delay will be used with a
        backoff doubling between retry attempts. The delay value will increase until this limit is
        reached.

config GOLIOTH_FW_UPDATE_THREAD_STACK_SIZE
    int "Golioth OTA thread stack size"
    default 4096
    help
        Stack size of thread handling OTA updates.

config GOLIOTH_FW_UPDATE_ROLLBACK_TIMER_S
    int "FW Update rollback timer period"
    default 300
    help
        The time, in seconds, that the firmware update thread will wait for a connection to
        Golioth after the first boot into a new firmware image. If a connection is not established
        within this period, the firmware update module will roll back the firmware to the previous
        version.
```

## examples/esp_idf/fw_update/sdkconfig.defaults
```kconfig
CONFIG_MBEDTLS_SSL_PROTO_DTLS=y
CONFIG_MBEDTLS_PSK_MODES=y
CONFIG_MBEDTLS_KEY_EXCHANGE_PSK=y
CONFIG_MBEDTLS_TLS_CLIENT_ONLY=y
CONFIG_LWIP_NETBUF_RECVINFO=y
CONFIG_FREERTOS_USE_TRACE_FACILITY=y
CONFIG_FREERTOS_USE_STATS_FORMATTING_FUNCTIONS=y
CONFIG_ESP_WIFI_SOFTAP_SUPPORT=n

CONFIG_COMPILER_OPTIMIZATION_SIZE=y

# GLTH_LOGX statements will automatically upload to Golioth Logs service
CONFIG_GOLIOTH_AUTO_LOG_TO_CLOUD=y
CONFIG_GOLIOTH_COAP_REQUEST_QUEUE_MAX_ITEMS=20

# OTA Partition Table
CONFIG_ESPTOOLPY_FLASHSIZE_4MB=y
CONFIG_PARTITION_TABLE_CUSTOM=y
CONFIG_PARTITION_TABLE_CUSTOM_FILENAME="partitions.csv"

# If the new app firmware does not cancel the rollback,
# then this will ensure that rollback happens automatically
# if/when the device is next rebooted.
CONFIG_BOOTLOADER_APP_ROLLBACK_ENABLE=y

# Golioth Services
CONFIG_GOLIOTH_OTA=y

# To enable hardcode credentials, set to y
CONFIG_GOLIOTH_SAMPLE_HARDCODED_CREDENTIALS=n

# If you set CONFIG_GOLIOTH_SAMPLE_HARDCODED_CREDENTIALS to y,
# uncomment the following and set appropriate values for hardcoding credentials
#CONFIG_GOLIOTH_SAMPLE_PSK_ID="my-psk-id"
#CONFIG_GOLIOTH_SAMPLE_PSK="my-psk"
```

## examples/esp_idf/golioth_basics/main/Kconfig
```kconfig
#
# Copyright (C) 2024 Golioth, Inc.
#
# SPDX-License-Identifier: Apache-2.0
#

rsource '../../common/Kconfig'
```

## examples/esp_idf/golioth_basics/main/Kconfig.projbuild
```kconfig
menu "Golioth Example Configuration"

config GOLIOTH_BLE_SERVICE_ENABLED
    bool "Enable BLE provisioning service"
    depends on BT_NIMBLE_ENABLED
    default n
    help
        Enables the NimBLE stack and executes a GATT
        server that serves a provisioning service for
        settings WiFi and Golioth credentials.

endmenu
```

## examples/esp_idf/golioth_basics/sdkconfig.defaults
```kconfig
CONFIG_MBEDTLS_SSL_PROTO_DTLS=y
CONFIG_MBEDTLS_PSK_MODES=y
CONFIG_MBEDTLS_KEY_EXCHANGE_PSK=y
CONFIG_MBEDTLS_TLS_CLIENT_ONLY=y
CONFIG_MBEDTLS_SHA512_C=n
CONFIG_LWIP_NETBUF_RECVINFO=y
CONFIG_FREERTOS_USE_TRACE_FACILITY=y
CONFIG_FREERTOS_USE_STATS_FORMATTING_FUNCTIONS=y
CONFIG_ESP_WIFI_SOFTAP_SUPPORT=n

CONFIG_COMPILER_OPTIMIZATION_SIZE=y

# OTA Partition Table
CONFIG_ESPTOOLPY_FLASHSIZE_4MB=y
CONFIG_PARTITION_TABLE_CUSTOM=y
CONFIG_PARTITION_TABLE_CUSTOM_FILENAME="partitions.csv"

# If the new app firmware does not cancel the rollback,
# then this will ensure that rollback happens automatically
# if/when the device is next rebooted.
CONFIG_BOOTLOADER_APP_ROLLBACK_ENABLE=y

# Bluetooth
CONFIG_GOLIOTH_BLE_SERVICE_ENABLED=y
CONFIG_BT_ENABLED=y
CONFIG_BTDM_CTRL_MODE_BLE_ONLY=y
CONFIG_BTDM_CTRL_MODE_BR_EDR_ONLY=n
CONFIG_BTDM_CTRL_MODE_BTDM=n
CONFIG_BT_BLUEDROID_ENABLED=n
CONFIG_BT_NIMBLE_ENABLED=y
CONFIG_BT_NIMBLE_MAX_CONNECTIONS=2
CONFIG_BTDM_CTRL_BLE_MAX_CONN=2
CONFIG_BT_NIMBLE_ROLE_PERIPHERAL=y
CONFIG_BT_NIMBLE_ROLE_CENTRAL=n
CONFIG_BT_NIMBLE_ROLE_BROADCASTER=n
CONFIG_BT_NIMBLE_ROLE_OBSERVER=n

# GLTH_LOGX statements will automatically upload to Golioth Logs service
CONFIG_GOLIOTH_AUTO_LOG_TO_CLOUD=1
CONFIG_GOLIOTH_COAP_REQUEST_QUEUE_MAX_ITEMS=20

# Golioth Services
CONFIG_GOLIOTH_LIGHTDB_STREAM=y
CONFIG_GOLIOTH_RPC=y
CONFIG_GOLIOTH_SETTINGS=y
```

## examples/esp_idf/hello/sdkconfig.defaults
```kconfig
CONFIG_MBEDTLS_SSL_PROTO_DTLS=y
CONFIG_MBEDTLS_PSK_MODES=y
CONFIG_MBEDTLS_KEY_EXCHANGE_PSK=y
CONFIG_MBEDTLS_TLS_CLIENT_ONLY=y
CONFIG_LWIP_NETBUF_RECVINFO=y
CONFIG_FREERTOS_USE_TRACE_FACILITY=y
CONFIG_FREERTOS_USE_STATS_FORMATTING_FUNCTIONS=y
CONFIG_ESP_WIFI_SOFTAP_SUPPORT=n

CONFIG_COMPILER_OPTIMIZATION_SIZE=y

# GLTH_LOGX statements will automatically upload to Golioth Logs service
CONFIG_GOLIOTH_AUTO_LOG_TO_CLOUD=y
CONFIG_GOLIOTH_COAP_REQUEST_QUEUE_MAX_ITEMS=20

# To enable hardcode credentials, set to y
CONFIG_GOLIOTH_SAMPLE_HARDCODED_CREDENTIALS=n

# If you set CONFIG_GOLIOTH_SAMPLE_HARDCODED_CREDENTIALS to y,
# uncomment the following and set appropriate values for hardcoding credentials
#CONFIG_GOLIOTH_SAMPLE_PSK_ID="my-psk-id"
#CONFIG_GOLIOTH_SAMPLE_PSK="my-psk"
```

## examples/esp_idf/magtag_demo/sdkconfig.defaults
```kconfig
CONFIG_MBEDTLS_SSL_PROTO_DTLS=y
CONFIG_MBEDTLS_PSK_MODES=y
CONFIG_MBEDTLS_KEY_EXCHANGE_PSK=y
CONFIG_MBEDTLS_TLS_CLIENT_ONLY=y
CONFIG_MBEDTLS_SHA512_C=n
CONFIG_LWIP_NETBUF_RECVINFO=y
CONFIG_FREERTOS_USE_TRACE_FACILITY=y
CONFIG_FREERTOS_USE_STATS_FORMATTING_FUNCTIONS=y
CONFIG_ESP_WIFI_SOFTAP_SUPPORT=n

# TODO - re-enable once resolved: https://github.com/espressif/esp-idf/issues/10322
#CONFIG_COMPILER_OPTIMIZATION_SIZE=y

# Refer to Adafruit schematic:
# https://cdn-learn.adafruit.com/assets/assets/000/096/946/original/adafruit_products_MagTag_sch.png?1605026160
CONFIG_EXAMPLE_RMT_TX_GPIO=1
CONFIG_EXAMPLE_STRIP_LED_NUMBER=4

CONFIG_ESP_CONSOLE_USB_CDC=y
```

## examples/esp_idf/rpc/sdkconfig.defaults
```kconfig
CONFIG_MBEDTLS_SSL_PROTO_DTLS=y
CONFIG_MBEDTLS_PSK_MODES=y
CONFIG_MBEDTLS_KEY_EXCHANGE_PSK=y
CONFIG_MBEDTLS_TLS_CLIENT_ONLY=y
CONFIG_MBEDTLS_SHA512_C=n
CONFIG_LWIP_NETBUF_RECVINFO=y
CONFIG_FREERTOS_USE_TRACE_FACILITY=y
CONFIG_FREERTOS_USE_STATS_FORMATTING_FUNCTIONS=y
CONFIG_ESP_WIFI_SOFTAP_SUPPORT=n

CONFIG_COMPILER_OPTIMIZATION_SIZE=y

# GLTH_LOGX statements will automatically upload to Golioth Logs service
CONFIG_GOLIOTH_AUTO_LOG_TO_CLOUD=1
CONFIG_GOLIOTH_COAP_REQUEST_QUEUE_MAX_ITEMS=20

# Golioth Services
CONFIG_GOLIOTH_RPC=y
```

## examples/esp_idf/test/sdkconfig.defaults
```kconfig
CONFIG_MBEDTLS_SSL_PROTO_DTLS=y
CONFIG_MBEDTLS_PSK_MODES=y
CONFIG_MBEDTLS_KEY_EXCHANGE_PSK=y
CONFIG_MBEDTLS_TLS_CLIENT_ONLY=y
CONFIG_MBEDTLS_SHA512_C=n
CONFIG_LWIP_NETBUF_RECVINFO=y
CONFIG_FREERTOS_USE_TRACE_FACILITY=y
CONFIG_FREERTOS_USE_STATS_FORMATTING_FUNCTIONS=y
CONFIG_ESP_WIFI_SOFTAP_SUPPORT=n

CONFIG_COMPILER_OPTIMIZATION_SIZE=y

CONFIG_ESPTOOLPY_FLASHSIZE_4MB=y
CONFIG_PARTITION_TABLE_CUSTOM=y
CONFIG_PARTITION_TABLE_CUSTOM_FILENAME="partitions.csv"

# If the new app firmware does not cancel the rollback,
# then this will ensure that rollback happens automatically
# if/when the device is next rebooted.
CONFIG_BOOTLOADER_APP_ROLLBACK_ENABLE=y

CONFIG_ESP_SYSTEM_PANIC_PRINT_HALT=y
CONFIG_LOG_DEFAULT_LEVEL_DEBUG=y
CONFIG_UNITY_ENABLE_IDF_TEST_RUNNER=n
CONFIG_GOLIOTH_ALLOCATION_TRACKING=1
CONFIG_ESP_COREDUMP_DECODE=y

CONFIG_GOLIOTH_AUTO_LOG_TO_CLOUD=n

CONFIG_GOLIOTH_COAP_HOST_URI="coaps://coap.golioth.dev"
```

## examples/zephyr/common/Kconfig
```kconfig
#
# Copyright (C) 2021-2024 Golioth, Inc.
#
# SPDX-License-Identifier: Apache-2.0
#

menuconfig GOLIOTH_SAMPLE_COMMON
	bool "Common helper code shared across multiple samples"
	help
	  Build and link common code that is shared across Golioth samples.

if GOLIOTH_SAMPLE_COMMON

choice GOLIOTH_SAMPLE_AUTH_TYPE
	prompt "Authentication type"

config GOLIOTH_SAMPLE_AUTH_TYPE_PSK
	bool "PSK"
	depends on GOLIOTH_AUTH_METHOD_PSK

config GOLIOTH_SAMPLE_AUTH_TYPE_PKI
	bool "PKI"
	depends on GOLIOTH_AUTH_METHOD_CERT

config GOLIOTH_SAMPLE_AUTH_TYPE_TAG
	bool "Tag"

endchoice

config GOLIOTH_SAMPLE_DHCP_BIND
	bool "DHCP for samples"
	depends on NET_L2_ETHERNET
	depends on NET_DHCPV4
	help
	  Obtain an IPv4 address from the DHCP server.

# NCS and Zephyr use different integer sizes for network management events
config GOLIOTH_SAMPLE_NET_EVENT_SIZE
	int
	default 64 if !NRF_SECURITY
	default 32 if NRF_SECURITY

config GOLIOTH_SAMPLE_NRF91_LTE_MONITOR
	bool "nRF91 LTE monitor"
	default y
	depends on LOG
	depends on LTE_LINK_CONTROL
	help
	  LTE Link Control events monitor for nRF91.

if GOLIOTH_SAMPLE_NRF91_LTE_MONITOR

config GOLIOTH_SAMPLE_NRF91_LTE_MONITOR_LOG_LEVEL
	int "Default log level for LTE Monitor"
	default 3
	help
	  The default log level for the LTE Monitor in the Golioth common library.

	  0: NONE
	  1: ERR
	  2: WRN
	  3: INF
	  4: DBG

endif # GOLIOTH_SAMPLE_NRF91_LTE_MONITOR

config GOLIOTH_SAMPLE_NRF91_RESET_LOOP_OVERRIDE
	bool "Automatically override modem reset loop restriction"
	depends on GOLIOTH_SAMPLE_NRF91_LTE_MONITOR
	help
	  When selected, the device will automatically factory reset the modem
	  when the modem reports that it has activated the reset loop restriction.
	  This will remove the reset loop restriction.

	  WARNING: It is not recommended to activate this setting in production.

config GOLIOTH_SAMPLE_SETTINGS
	bool

choice GOLIOTH_SAMPLE_CREDENTIALS
	prompt "Load credentials automatically"
	default GOLIOTH_SAMPLE_CREDENTIALS_NSI if (GOLIOTH_AUTH_METHOD_PSK && NATIVE_LIBRARY)
	default GOLIOTH_SAMPLE_CREDENTIALS_SETTINGS if (GOLIOTH_AUTH_METHOD_PSK && SETTINGS)
	default GOLIOTH_SAMPLE_CREDENTIALS_DISABLED

config GOLIOTH_SAMPLE_CREDENTIALS_NSI
	bool "From NSI host environment variables"
	depends on GOLIOTH_AUTH_METHOD_PSK
	depends on NATIVE_LIBRARY
	help
	  When selected, Golioth credentials will be loaded from Native Simulator
	  host environment variables.

config GOLIOTH_SAMPLE_CREDENTIALS_SETTINGS
	bool "From persistent settings"
	depends on GOLIOTH_AUTH_METHOD_PSK
	depends on SETTINGS
	select GOLIOTH_SAMPLE_SETTINGS
	help
	  When selected, Golioth credentials will be loaded from settings
	  subsystem.

config GOLIOTH_SAMPLE_CREDENTIALS_DISABLED
	bool "Disabled"
	help
	  When selected, no credentials will be loaded into Zephyr TLS credentials
	  subsystem.

endchoice

if GOLIOTH_SAMPLE_CREDENTIALS_NSI || GOLIOTH_SAMPLE_CREDENTIALS_SETTINGS

config GOLIOTH_SAMPLE_PSK_ID_MAX_LEN
	int "Max length of PSK ID"
	default 64
	help
	  Maximum length of PSK ID, in bytes.

config GOLIOTH_SAMPLE_PSK_MAX_LEN
	int "Max length of PSK"
	default MBEDTLS_PSK_MAX_LEN if MBEDTLS_BUILTIN
	default 32
	help
      Maximum length of PSK, in bytes. Modification may require also updating
      MBEDTLS_PSK_MAX_LEN.

endif # GOLIOTH_SAMPLE_CREDENTIALS_NSI || GOLIOTH_SAMPLE_CREDENTIALS_SETTINGS

config GOLIOTH_SAMPLE_SETTINGS_AUTOLOAD
	bool "Automatically load settings before main()"
	default y if GOLIOTH_SAMPLE_SETTINGS
	depends on SETTINGS
	help
	  Load settings automatically before running main() function. Enable it,
	  so that application does not need to call settings_load() manually.

config GOLIOTH_SAMPLE_SETTINGS_SHELL
	bool "Settings shell"
	default y if GOLIOTH_SAMPLE_SETTINGS
	depends on SHELL
	depends on SETTINGS
	depends on !SETTINGS_SHELL
	help
	  Golioth specific settings shell. Enable it when reading and
	  writing string based settings is desired. Look at Zephyr's
	  settings shell implementation (SETTINGS_SHELL) when byte
	  strings are needed to be handled as well.

config GOLIOTH_SAMPLE_WIFI
	bool "WiFi utilities for samples"
	depends on NET_L2_WIFI_MGMT
	help
	  Enable utilities for easy WiFi setup, mainly for use inside samples/.

if GOLIOTH_SAMPLE_WIFI

config GOLIOTH_SAMPLE_WIFI_STACK_SIZE
	int "WiFi manager stack size"
	default 2048

config GOLIOTH_SAMPLE_WIFI_INIT_PRIORITY
	int "WiFi manager init priority"
	default 90

config GOLIOTH_SAMPLE_WIFI_THREAD_PRIORITY
	int "WiFi manager thread priority"
	default 7

config GOLIOTH_SAMPLE_WIFI_SETTINGS
	bool "Load SSID and PSK from settings subsystem"
	default y
	depends on SETTINGS
	select GOLIOTH_SAMPLE_SETTINGS
	help
	  Load WiFi SSID and PSK from settings subsystem, from 'wifi/ssid' and
	  'wifi/psk' entries.

endif # GOLIOTH_SAMPLE_WIFI

config GOLIOTH_SAMPLE_TWISTER_TEST
	bool "Twister test"
	help
	  Helper option used for selecting better defaults for Twister (Hardware-in-the-loop or Native
	  Simulator) tests, e.g. for increased tests reliability.

endif # GOLIOTH_SAMPLE_COMMON
```
