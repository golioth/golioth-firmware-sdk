## src/Kconfig.coap
```kconfig
#
# Copyright (C) 2024 Golioth, Inc.
#
# SPDX-License-Identifier: Apache-2.0
#
#

config GOLIOTH_COAP_HOST_URI
    string "CoAP server URI"
    default "coaps://coap.golioth.io"
    help
        The URI of the CoAP server

config GOLIOTH_COAP_RESPONSE_TIMEOUT_S
    int "CoAP response timeout"
    default 10
    help
        Maximum time, in seconds, the CoAP thread will block while waiting
        for a response from the server.

config GOLIOTH_COAP_REQUEST_QUEUE_TIMEOUT_MS
    int "CoAP request queue timeout"
    default 1000
    help
        Maximum time, in milliseconds, the CoAP thread will block while
        waiting for something to arrive in the request queue.
        This is also how often to poll for received observations.

config GOLIOTH_COAP_REQUEST_QUEUE_MAX_ITEMS
    int "CoAP request queue max num items"
    default 10
    help
        The size, in items, of the CoAP thread request queue.
        If the queue is full, any attempts to queue new messages
        will fail.

config GOLIOTH_MAX_NUM_OBSERVATIONS
    int "Golioth CoAP maximum number observations"
    default 8
    help
        The maximum number of CoAP paths which can be simultaneously observed.

choice GOLIOTH_BLOCKSIZE_DN
    prompt "Golioth blockwise download: Max block size"
    help
        Buffer size used in blockwise downloads. This choice is assigned to
        GOLIOTH_BLOCKWISE_DOWNLOAD_MAX_BLOCK_SIZE. The block download size negotiated with the
        server will be no larger than the value of this setting.

    config GOLIOTH_BLOCKSIZE_DN_1024
        bool "1024"
    config GOLIOTH_BLOCKSIZE_DN_512
        bool "512"
    config GOLIOTH_BLOCKSIZE_DN_256
        bool "256"
    config GOLIOTH_BLOCKSIZE_DN_128
        bool "128"
    config GOLIOTH_BLOCKSIZE_DN_64
        bool "64"
    config GOLIOTH_BLOCKSIZE_DN_32
        bool "32"
    config GOLIOTH_BLOCKSIZE_DN_16
        bool "16"

endchoice # GOLIOTH_BLOCKSIZE_DN

config GOLIOTH_BLOCKWISE_DOWNLOAD_MAX_BLOCK_SIZE
    int
    default 1024 if GOLIOTH_BLOCKSIZE_DN_1024
    default 512 if GOLIOTH_BLOCKSIZE_DN_512
    default 256 if GOLIOTH_BLOCKSIZE_DN_256
    default 128 if GOLIOTH_BLOCKSIZE_DN_128
    default 64 if GOLIOTH_BLOCKSIZE_DN_64
    default 32 if GOLIOTH_BLOCKSIZE_DN_32
    default 16 if GOLIOTH_BLOCKSIZE_DN_16
    help
        Buffer size used in blockwise downloads. The block download size negotiated with the server
        will be no larger than the value of this setting.

choice GOLIOTH_BLOCKSIZE_UP
    prompt "Golioth blockwise upload: Max block size"
    help
        Buffer size used in blockwise uploads. This choice is assigned to
        GOLIOTH_BLOCKWISE_UPLOAD_MAX_BLOCK_SIZE. The block upload size negotiated with the server
        will be no larger than the value of this setting.

    config GOLIOTH_BLOCKSIZE_UP_1024
        bool "1024"
    config GOLIOTH_BLOCKSIZE_UP_512
        bool "512"
    config GOLIOTH_BLOCKSIZE_UP_256
        bool "256"
    config GOLIOTH_BLOCKSIZE_UP_128
        bool "128"
    config GOLIOTH_BLOCKSIZE_UP_64
        bool "64"
    config GOLIOTH_BLOCKSIZE_UP_32
        bool "32"
    config GOLIOTH_BLOCKSIZE_UP_16
        bool "16"

endchoice # GOLIOTH_BLOCKSIZE_UP

config GOLIOTH_BLOCKWISE_UPLOAD_MAX_BLOCK_SIZE
    int
    default 1024 if GOLIOTH_BLOCKSIZE_UP_1024
    default 512 if GOLIOTH_BLOCKSIZE_UP_512
    default 256 if GOLIOTH_BLOCKSIZE_UP_256
    default 128 if GOLIOTH_BLOCKSIZE_UP_128
    default 64 if GOLIOTH_BLOCKSIZE_UP_64
    default 32 if GOLIOTH_BLOCKSIZE_UP_32
    default 16 if GOLIOTH_BLOCKSIZE_UP_16
    help
        Buffer size used in blockwise uploads. The block upload size negotiated with the server will
        be no larger than the value of this setting.

config GOLIOTH_COAP_THREAD_PRIORITY
    int "Golioth CoAP thread priority"
    default 5
    help
        Thread priority of the Golioth CoAP thread.

config GOLIOTH_COAP_THREAD_STACK_SIZE
    int "Golioth CoAP thread stack size"
    default 6144
    help
        Thread stack size of the Golioth CoAP thread, in bytes.

config GOLIOTH_COAP_KEEPALIVE_INTERVAL_S
    int "Golioth CoAP keepalive interval, in seconds"
    default 9
    help
        How often to send a "keepalive" dummy client request to the server.
        If the session is idle for this amount of time, then the keepalive
        request will be sent.
        Can be useful to keep the CoAP session active, and to mitigate
        against NAT and server timeouts.
        Set to 0 to disable.
```
